/dts-v1/;

/ {

	fragment@0 {
		target = <0xffffffff>;

		__overlay__ {
			atag,videolfb-fb_base_h = <0x00>;
			atag,videolfb-fb_base_l = "^`P";
			atag,videolfb-islcmfound = <0x01>;
			atag,videolfb-islcm_inited = <0x00>;
			atag,videolfb-fps = <0x1770>;
			atag,videolfb-vramSize = <0x17bb000>;
			atag,videolfb-lcmname = "nt35695B_fhd_dsi_cmd_auo_rt5081_drv";
		};
	};

	fragment@1 {
		target = <0xffffffff>;

		__overlay__ {

			led@0 {
				compatible = "mediatek,red";
				led_mode = <0x03>;
				data = <0x01>;
				pwm_config = <0x00 0x00 0x00 0x00 0x00>;
				linux,phandle = <0x51>;
				phandle = <0x51>;
			};

			led@1 {
				compatible = "mediatek,green";
				led_mode = <0x03>;
				data = <0x02>;
				pwm_config = <0x00 0x00 0x00 0x00 0x00>;
				linux,phandle = <0x52>;
				phandle = <0x52>;
			};

			led@2 {
				compatible = "mediatek,blue";
				led_mode = <0x00>;
				data = <0x01>;
				pwm_config = <0x00 0x00 0x00 0x00 0x00>;
				linux,phandle = <0x53>;
				phandle = <0x53>;
			};

			led@3 {
				compatible = "mediatek,jogball-backlight";
				led_mode = <0x00>;
				data = <0x01>;
				pwm_config = <0x00 0x00 0x00 0x00 0x00>;
				linux,phandle = <0x54>;
				phandle = <0x54>;
			};

			led@4 {
				compatible = "mediatek,keyboard-backlight";
				led_mode = <0x00>;
				data = <0x01>;
				pwm_config = <0x00 0x00 0x00 0x00 0x00>;
				linux,phandle = <0x55>;
				phandle = <0x55>;
			};

			led@5 {
				compatible = "mediatek,button-backlight";
				led_mode = <0x00>;
				data = <0x01>;
				pwm_config = <0x00 0x00 0x00 0x00 0x00>;
				linux,phandle = <0x56>;
				phandle = <0x56>;
			};

			led@6 {
				compatible = "mediatek,lcd-backlight";
				led_mode = <0x04>;
				data = <0x01>;
				pwm_config = <0x00 0x02 0x00 0x00 0x00>;
				linux,phandle = <0x57>;
				phandle = <0x57>;
			};

			vibrator@0 {
				compatible = "mediatek,vibrator";
				vib_timer = <0x19>;
				vib_limit = <0x09>;
				vib_vol = <0x0b>;
				linux,phandle = <0x58>;
				phandle = <0x58>;
			};

			memory-ssmr-features {
				compatible = "mediatek,memory-ssmr-features";
				svp-size = <0x00 0x10000000>;
				iris-recognition-size = <0x00 0x00>;
				2d_fr-size = <0x00 0x00>;
				tui-size = <0x00 0x00>;
				wfd-size = <0x00 0x00>;
				prot-sharedmem-size = <0x00 0x00>;
				linux,phandle = <0x59>;
				phandle = <0x59>;
			};
		};
	};

	fragment@2 {
		target = <0xffffffff>;

		__overlay__ {

			ext_buck_lp4@57 {
				regulator-name = "ext_buck_vdd2";
				regulator-min-microvolt = <0x493e0>;
				regulator-max-microvolt = <0x13d620>;
				vsel_pin = <0x00>;
			};

			ext_buck_lp4x@50 {
				regulator-name = "ext_buck_vddq";
				regulator-min-microvolt = <0x493e0>;
				regulator-max-microvolt = <0x13d620>;
				vsel_pin = <0x01>;
			};
		};
	};

	fragment@3 {
		target = <0xffffffff>;

		__overlay__ {
			#address-cells = <0x01>;
			#size-cells = <0x00>;
			clock-frequency = <0x61a80>;

			externel-charger@6c {
				compatible = "halo,hl7007";
				reg = <0x6c>;
				status = "okay";
				ichg = <0x100590>;
			};

			externel-charger@6a {
				compatible = "halo,hl7005";
				reg = <0x6a>;
				status = "okay";
				ichg = <0x100590>;
			};

			externel-eta-charger@6e {
				compatible = "ontim,eta6937";
				reg = <0x6e>;
				status = "okay";
				ichg = <0x118c30>;
			};

			externel-charger@6d {
				compatible = "halo,sy6923";
				reg = <0x6d>;
				status = "okay";
				ichg = <0x118c30>;
			};

			externel-charger@6f {
				compatible = "halo,bq24157";
				reg = <0x6f>;
				status = "okay";
				ichg = <0x118c30>;
			};

			externel-charger@6b {
				compatible = "ti,bq25601";
				reg = <0x6b>;
				status = "okay";
			};

			externel-charger@53 {
				compatible = "richtek,rt9471";
				reg = <0x53>;
				status = "okay";
				ichg = <0x1e8480>;
			};
		};
	};

	fragment@4 {
		target = <0xffffffff>;

		__overlay__ {

			ext_buck_vgpu@55 {
				regulator-name = "ext_buck_vgpu";
				regulator-min-microvolt = <0x493e0>;
				regulator-max-microvolt = <0x13d620>;
				vsel_pin = <0x02>;
			};
		};
	};

	fragment@5 {
		target = <0xffffffff>;

		__overlay__ {
			#address-cells = <0x01>;
			#size-cells = <0x00>;
			clock-frequency = <0x61a80>;
			mediatek,use-open-drain;

			focaltech_touch@38 {
				compatible = "mediatek,focaltech_touch";
				reg = <0x38>;
				status = "okay";
				linux,phandle = <0x5a>;
				phandle = <0x5a>;
			};

			ili9881x_touch@42 {
				compatible = "mediatek,ili9881x_touch";
				reg = <0x42>;
				status = "okay";
				linux,phandle = <0x5b>;
				phandle = <0x5b>;
			};

			ilitek_touch@41 {
				compatible = "mediatek,ilitek_touch";
				reg = <0x41>;
				status = "okay";
				linux,phandle = <0x5c>;
				phandle = <0x5c>;
			};

			chipone_touch@48 {
				compatible = "mediatek,chipone_tddi";
				reg = <0x48>;
				status = "okay";
				linux,phandle = <0x5d>;
				phandle = <0x5d>;
			};
		};
	};

	fragment@6 {
		target = <0xffffffff>;

		__overlay__ {
			tpd-resolution = <0x2d0 0x618>;
			use-tpd-button = <0x00>;
			tpd-key-num = <0x03>;
			tpd-key-local = <0x8b 0xac 0x9e 0x00>;
			tpd-key-dim-local = <0x5a 0x373 0x64 0x28 0xe6 0x373 0x64 0x28 0x172 0x373 0x64 0x28 0x00 0x00 0x00 0x00>;
			tpd-max-touch-num = <0x0a>;
			tpd-filter-enable = <0x01>;
			tpd-filter-pixel-density = <0x6a>;
			tpd-filter-custom-prameters = <0x00 0x00 0x00 0x00 0x00 0x00 0x00 0x00 0x00 0x00 0x00 0x00>;
			tpd-filter-custom-speed = <0x00 0x00 0x00>;
			pinctrl-names = "default\0state_eint_as_int\0state_eint_output0\0state_eint_output1\0state_rst_output0\0state_rst_output1";
			pinctrl-0 = <0x01>;
			pinctrl-1 = <0x02>;
			pinctrl-2 = <0x03>;
			pinctrl-3 = <0x04>;
			pinctrl-4 = <0x05>;
			pinctrl-5 = <0x06>;
			status = "okay";
		};
	};

	fragment@7 {
		target = <0xffffffff>;

		__overlay__ {

			eint0default {
				linux,phandle = <0x01>;
				phandle = <0x01>;
			};

			eint@0 {
				linux,phandle = <0x02>;
				phandle = <0x02>;

				pins_cmd_dat {
					pinmux = <0x00>;
					slew-rate = <0x00>;
					bias-disable;
				};
			};

			eintoutput0 {
				linux,phandle = <0x03>;
				phandle = <0x03>;

				pins_cmd_dat {
					pinmux = <0x00>;
					slew-rate = <0x01>;
					output-low;
				};
			};

			eintoutput1 {
				linux,phandle = <0x04>;
				phandle = <0x04>;

				pins_cmd_dat {
					pinmux = <0x00>;
					slew-rate = <0x01>;
					output-high;
				};
			};

			rstoutput0 {
				linux,phandle = <0x05>;
				phandle = <0x05>;

				pins_cmd_dat {
					pinmux = <0xae00>;
					slew-rate = <0x01>;
					output-low;
				};
			};

			rstoutput1 {
				linux,phandle = <0x06>;
				phandle = <0x06>;

				pins_cmd_dat {
					pinmux = <0xae00>;
					slew-rate = <0x01>;
					output-high;
				};
			};
		};
	};

	fragment@8 {
		target = <0xffffffff>;

		__overlay__ {
			#address-cells = <0x01>;
			#size-cells = <0x00>;
			clock-frequency = <0x61a80>;

			lcd_i2c_bias_enn_enp@3e {
				compatible = "mediatek,I2C_LCD_BIAS";
				reg = <0x3e>;
				status = "okay";
			};
		};
	};

	fragment@9 {
		target = <0xffffffff>;

		__overlay__ {

			mode_te_gpio {
				linux,phandle = <0x07>;
				phandle = <0x07>;

				pins_cmd_dat {
					pinmux = <0x2c01>;
				};
			};

			mode_te_te {
				linux,phandle = <0x08>;
				phandle = <0x08>;

				pins_cmd_dat {
					pinmux = <0x2c01>;
				};
			};

			lcm_rst_out0_gpio {
				linux,phandle = <0x09>;
				phandle = <0x09>;

				pins_cmd_dat {
					pinmux = <0x2d00>;
					slew-rate = <0x01>;
					output-low;
				};
			};

			lcm_rst_out1_gpio {
				linux,phandle = <0x0a>;
				phandle = <0x0a>;

				pins_cmd_dat {
					pinmux = <0x2d00>;
					slew-rate = <0x01>;
					output-high;
				};
			};

			lcd_bias_enp0_gpio {
				linux,phandle = <0x0b>;
				phandle = <0x0b>;

				pins_cmd_dat {
					pinmux = <0xac00>;
					slew-rate = <0x01>;
					output-low;
				};
			};

			lcd_bias_enp1_gpio {
				linux,phandle = <0x0c>;
				phandle = <0x0c>;

				pins_cmd_dat {
					pinmux = <0xac00>;
					slew-rate = <0x01>;
					output-high;
				};
			};

			lcd_bias_enn0_gpio {
				linux,phandle = <0x0d>;
				phandle = <0x0d>;

				pins_cmd_dat {
					pinmux = <0xad00>;
					slew-rate = <0x01>;
					output-low;
				};
			};

			lcd_bias_enn1_gpio {
				linux,phandle = <0x0e>;
				phandle = <0x0e>;

				pins_cmd_dat {
					pinmux = <0xad00>;
					slew-rate = <0x01>;
					output-high;
				};
			};
		};
	};

	fragment@10 {
		target = <0xffffffff>;

		__overlay__ {
			pinctrl-names = "mode_te_gpio\0mode_te_te\0lcm_rst_out0_gpio\0lcm_rst_out1_gpio\0lcd_bias_enp0_gpio\0lcd_bias_enp1_gpio\0lcd_bias_enn0_gpio\0lcd_bias_enn1_gpio";
			pinctrl-0 = <0x07>;
			pinctrl-1 = <0x08>;
			pinctrl-2 = <0x09>;
			pinctrl-3 = <0x0a>;
			pinctrl-4 = <0x0b>;
			pinctrl-5 = <0x0c>;
			pinctrl-6 = <0x0d>;
			pinctrl-7 = <0x0e>;
			status = "okay";
		};
	};

	fragment@11 {
		target = <0xffffffff>;

		__overlay__ {

			consys_default {
				linux,phandle = <0x0f>;
				phandle = <0x0f>;
			};

			gpslna@0 {
				linux,phandle = <0x10>;
				phandle = <0x10>;

				pins_cmd_dat {
					pinmux = <0x5b00>;
					slew-rate = <0x00>;
					bias-disable;
					output-low;
				};
			};

			gpslna@1 {
				linux,phandle = <0x11>;
				phandle = <0x11>;

				pins_cmd_dat {
					pinmux = <0x5b00>;
					slew-rate = <0x01>;
					output-high;
				};
			};

			gpslna@2 {
				linux,phandle = <0x12>;
				phandle = <0x12>;

				pins_cmd_dat {
					pinmux = <0x5b00>;
					slew-rate = <0x01>;
					output-low;
				};
			};
		};
	};

	fragment@12 {
		target = <0xffffffff>;

		__overlay__ {
			pinctrl-names = "default\0gps_lna_state_init\0gps_lna_state_oh\0gps_lna_state_ol";
			pinctrl-0 = <0x0f>;
			pinctrl-1 = <0x10>;
			pinctrl-2 = <0x11>;
			pinctrl-3 = <0x12>;
			status = "okay";
		};
	};

	fragment@13 {
		target = <0xffffffff>;

		__overlay__ {
			accdet-mic-vol = <0x06>;
			headset-mode-setting = <0x500 0x500 0x01 0x1f0 0x800 0x800 0x20 0x44>;
			accdet-plugout-debounce = <0x01>;
			accdet-mic-mode = <0x01>;
			headset-eint-level-pol = <0x08>;
			headset-three-key-threshold = <0x00 0x50 0xaf 0x190>;
			headset-three-key-threshold-CDD = <0x00 0x79 0xc0 0x258>;
			headset-four-key-threshold = <0x00 0x3a 0x79 0xc0 0x190>;
			pinctrl-names = "default\0state_eint_as_int";
			pinctrl-0 = <0x13>;
			pinctrl-1 = <0x14>;
			status = "okay";
		};
	};

	fragment@14 {
		target = <0xffffffff>;

		__overlay__ {

			accdetdefault {
				linux,phandle = <0x13>;
				phandle = <0x13>;
			};

			accdeteint@0 {
				linux,phandle = <0x14>;
				phandle = <0x14>;
			};
		};
	};

	fragment@15 {
		target = <0xffffffff>;

		__overlay__ {
			usbcable-gpio = <0xffffffff 0x13 0x00>;
			pinctrl-names = "default";
			pinctrl-0 = <0x15>;
			status = "okay";
		};
	};

	fragment@16 {
		target = <0xffffffff>;

		__overlay__ {

			usbcableeint@0 {
				linux,phandle = <0x15>;
				phandle = <0x15>;

				pins_cmd_dat {
					pinmux = <0x1300>;
					slew-rate = <0x00>;
					bias-disable;
				};
			};
		};
	};

	fragment@17 {
		target = <0xffffffff>;

		__overlay__ {
			pinctrl-names = "default\0red_led_output0\0red_led_output1";
			pinctrl-0 = <0x16>;
			pinctrl-1 = <0x17>;
			pinctrl-2 = <0x18>;
			status = "okay";
		};
	};

	fragment@18 {
		target = <0xffffffff>;

		__overlay__ {

			led_default {
				linux,phandle = <0x16>;
				phandle = <0x16>;
			};

			led_output0 {
				linux,phandle = <0x17>;
				phandle = <0x17>;

				pins_cmd_dat {
					pinmux = <0x9f00>;
					slew-rate = <0x01>;
					output-low;
				};
			};

			led_output1 {
				linux,phandle = <0x18>;
				phandle = <0x18>;

				pins_cmd_dat {
					pinmux = <0x9f00>;
					slew-rate = <0x01>;
					output-high;
				};
			};
		};
	};

	fragment@19 {
		target = <0xffffffff>;

		__overlay__ {
			pinctrl-names = "irtx_gpio_led_default\0irtx_gpio_led_set";
			pinctrl-0 = <0x19>;
			pinctrl-1 = <0x1a>;
			status = "okay";
		};
	};

	fragment@20 {
		target = <0xffffffff>;

		__overlay__ {

			irtx_gpio_led_def@gpio90 {
				linux,phandle = <0x19>;
				phandle = <0x19>;

				pins_cmd_dat {
					pinmux = <0x5a00>;
					slew-rate = <0x01>;
					bias-disable;
					output-low;
					input-schmitt-enable = <0x00>;
				};
			};

			irtx_gpio_led_set@gpio90 {
				linux,phandle = <0x1a>;
				phandle = <0x1a>;

				pins_cmd_dat {
					pinmux = <0x5a02>;
					slew-rate = <0x01>;
					output-high;
				};
			};
		};
	};

	fragment@21 {
		target = <0xffffffff>;

		__overlay__ {
			pinctrl-names = "extamp-pulllow\0extamp-pullhigh";
			pinctrl-0 = <0x1b>;
			pinctrl-1 = <0x1c>;
			status = "okay";
		};
	};

	fragment@22 {
		target = <0xffffffff>;

		__overlay__ {

			aud_extamp_gpio_low {
				linux,phandle = <0x1b>;
				phandle = <0x1b>;

				pins_gpio_low {
					pinmux = <0x9900>;
					out-enable;
					slew-rate = <0x02>;
					bias-disable;
					output-low;
				};
			};

			aud_extamp_gpio_high {
				linux,phandle = <0x1c>;
				phandle = <0x1c>;

				pins_gpio_high {
					pinmux = <0x9900>;
					out-enable;
					slew-rate = <0x02>;
					bias-disable;
					output-high;
				};
			};
		};
	};

	fragment@23 {
		target = <0xffffffff>;

		__overlay__ {
			mt6370,intr_gpio_num = <0x0b>;
			mt6370,intr_gpio = <0xffffffff 0x0b 0x00>;
		};
	};

	fragment@24 {
		target = <0xffffffff>;

		__overlay__ {
			mt6370pd,intr_gpio_num = <0x29>;
			mt6370pd,intr_gpio = <0xffffffff 0x29 0x00>;
		};
	};

	fragment@25 {
		target = <0xffffffff>;

		__overlay__ {

			rt9465@4b {
				compatible = "richtek,rt9465";
				reg = <0x4b>;
				status = "okay";
				rt,en_gpio_num = <0xb0>;
				rt,en_gpio = <0xffffffff 0xb0 0x00>;
				rt,intr_gpio_num = <0x17>;
				rt,intr_gpio = <0xffffffff 0x17 0x00>;
				interrupt-names = "wdtmri";
				charger_name = "secondary_chg";
				ichg = <0x16e360>;
				mivr = <0x44aa20>;
				cv = <0x456d70>;
				ieoc = <0xaae60>;
				safety_timer = <0x0c>;
				en_st;
				en_wdt;
			};
		};
	};

	fragment@26 {
		target = <0xffffffff>;

		__overlay__ {

			camera_pins_cam0_mclk_on {
				linux,phandle = <0x34>;
				phandle = <0x34>;

				pins_cmd_dat {
					pinmux = <0x6301>;
				};
			};

			camera_pins_cam0_mclk_off {
				linux,phandle = <0x35>;
				phandle = <0x35>;

				pins_cmd_dat {
					pinmux = <0x6300>;
				};
			};

			camera_pins_cam1_mclk_on {
				linux,phandle = <0x36>;
				phandle = <0x36>;

				pins_cmd_dat {
					pinmux = <0x6401>;
				};
			};

			camera_pins_cam1_mclk_off {
				linux,phandle = <0x37>;
				phandle = <0x37>;

				pins_cmd_dat {
					pinmux = <0x6400>;
				};
			};

			camera_pins_cam2_mclk_on {
				linux,phandle = <0x38>;
				phandle = <0x38>;

				pins_cmd_dat {
					pinmux = <0x6c01>;
				};
			};

			camera_pins_cam2_mclk_off {
				linux,phandle = <0x39>;
				phandle = <0x39>;

				pins_cmd_dat {
					pinmux = <0x6c00>;
				};
			};

			cam0@0 {
				linux,phandle = <0x1e>;
				phandle = <0x1e>;

				pins_cmd_dat {
					pinmux = <0x6500>;
					slew-rate = <0x01>;
					output-low;
				};
			};

			cam0@1 {
				linux,phandle = <0x1f>;
				phandle = <0x1f>;

				pins_cmd_dat {
					pinmux = <0x6500>;
					slew-rate = <0x01>;
					output-high;
				};
			};

			cam0@2 {
				linux,phandle = <0x20>;
				phandle = <0x20>;

				pins_cmd_dat {
					pinmux = <0x6100>;
					slew-rate = <0x01>;
					output-low;
				};
			};

			cam0@3 {
				linux,phandle = <0x21>;
				phandle = <0x21>;

				pins_cmd_dat {
					pinmux = <0x6100>;
					slew-rate = <0x01>;
					output-high;
				};
			};

			cam1@0 {
				linux,phandle = <0x22>;
				phandle = <0x22>;

				pins_cmd_dat {
					pinmux = <0x6600>;
					slew-rate = <0x01>;
					output-low;
				};
			};

			cam1@1 {
				linux,phandle = <0x23>;
				phandle = <0x23>;

				pins_cmd_dat {
					pinmux = <0x6600>;
					slew-rate = <0x01>;
					output-high;
				};
			};

			cam1@2 {
				linux,phandle = <0x24>;
				phandle = <0x24>;

				pins_cmd_dat {
					pinmux = <0x6200>;
					slew-rate = <0x01>;
					output-low;
				};
			};

			cam1@3 {
				linux,phandle = <0x25>;
				phandle = <0x25>;

				pins_cmd_dat {
					pinmux = <0x6200>;
					slew-rate = <0x01>;
					output-high;
				};
			};

			cam2@0 {
				linux,phandle = <0x26>;
				phandle = <0x26>;

				pins_cmd_dat {
					pinmux = <0x6d00>;
					slew-rate = <0x01>;
					output-low;
				};
			};

			cam2@1 {
				linux,phandle = <0x27>;
				phandle = <0x27>;

				pins_cmd_dat {
					pinmux = <0x6d00>;
					slew-rate = <0x01>;
					output-high;
				};
			};

			cam2@2 {
				linux,phandle = <0x28>;
				phandle = <0x28>;

				pins_cmd_dat {
					pinmux = <0x6b00>;
					slew-rate = <0x01>;
					output-low;
				};
			};

			cam2@3 {
				linux,phandle = <0x29>;
				phandle = <0x29>;

				pins_cmd_dat {
					pinmux = <0x6b00>;
					slew-rate = <0x01>;
					output-high;
				};
			};

			cam0@vcamd0 {
				linux,phandle = <0x2b>;
				phandle = <0x2b>;

				pins_cmd_dat {
					pinmux = <0x5800>;
					slew-rate = <0x01>;
					output-low;
				};
			};

			cam0@vcamd1 {
				linux,phandle = <0x2a>;
				phandle = <0x2a>;

				pins_cmd_dat {
					pinmux = <0x5800>;
					slew-rate = <0x01>;
					output-high;
				};
			};

			cam1@vcamd0 {
				linux,phandle = <0x2d>;
				phandle = <0x2d>;

				pins_cmd_dat {
					pinmux = <0x1500>;
					slew-rate = <0x01>;
					output-low;
				};
			};

			cam1@vcamd1 {
				linux,phandle = <0x2c>;
				phandle = <0x2c>;

				pins_cmd_dat {
					pinmux = <0x1500>;
					slew-rate = <0x01>;
					output-high;
				};
			};

			cam1@vcama0 {
				linux,phandle = <0x2f>;
				phandle = <0x2f>;

				pins_cmd_dat {
					pinmux = <0xa900>;
					slew-rate = <0x01>;
					output-low;
				};
			};

			cam1@vcama1 {
				linux,phandle = <0x2e>;
				phandle = <0x2e>;

				pins_cmd_dat {
					pinmux = <0xa900>;
					slew-rate = <0x01>;
					output-high;
				};
			};

			cam2@vcama0 {
				linux,phandle = <0x31>;
				phandle = <0x31>;

				pins_cmd_dat {
					pinmux = <0x1500>;
					slew-rate = <0x01>;
					output-low;
				};
			};

			cam2@vcama1 {
				linux,phandle = <0x30>;
				phandle = <0x30>;

				pins_cmd_dat {
					pinmux = <0x1500>;
					slew-rate = <0x01>;
					output-high;
				};
			};

			cam2@vcamd0 {
				linux,phandle = <0x33>;
				phandle = <0x33>;

				pins_cmd_dat {
					pinmux = <0x1500>;
					slew-rate = <0x01>;
					output-low;
				};
			};

			cam2@vcamd1 {
				linux,phandle = <0x32>;
				phandle = <0x32>;

				pins_cmd_dat {
					pinmux = <0x1500>;
					slew-rate = <0x01>;
					output-high;
				};
			};

			camdefault {
				linux,phandle = <0x1d>;
				phandle = <0x1d>;
			};
		};
	};

	fragment@27 {
		target = <0xffffffff>;

		__overlay__ {
			pinctrl-names = "default\0cam0_rst0\0cam0_rst1\0cam0_pnd0\0cam0_pnd1\0cam1_rst0\0cam1_rst1\0cam1_pnd0\0cam1_pnd1\0cam2_rst0\0cam2_rst1\0cam2_pnd0\0cam2_pnd1\0cam0_vcamd_on\0cam0_vcamd_off\0cam1_vcamd_on\0cam1_vcamd_off\0cam1_vcama_on\0cam1_vcama_off\0cam2_vcamd_on\0cam2_vcamd_off\0cam2_vcama_on\0cam2_vcama_off\0cam0_mclk_on\0cam0_mclk_off\0cam1_mclk_on\0cam1_mclk_off\0cam2_mclk_on\0cam2_mclk_off";
			pinctrl-0 = <0x1d>;
			pinctrl-1 = <0x1e>;
			pinctrl-2 = <0x1f>;
			pinctrl-3 = <0x20>;
			pinctrl-4 = <0x21>;
			pinctrl-5 = <0x22>;
			pinctrl-6 = <0x23>;
			pinctrl-7 = <0x24>;
			pinctrl-8 = <0x25>;
			pinctrl-9 = <0x26>;
			pinctrl-10 = <0x27>;
			pinctrl-11 = <0x28>;
			pinctrl-12 = <0x29>;
			pinctrl-13 = <0x2a>;
			pinctrl-14 = <0x2b>;
			pinctrl-15 = <0x2c>;
			pinctrl-16 = <0x2d>;
			pinctrl-17 = <0x2e>;
			pinctrl-18 = <0x2f>;
			pinctrl-19 = <0x30>;
			pinctrl-20 = <0x31>;
			pinctrl-21 = <0x32>;
			pinctrl-22 = <0x33>;
			pinctrl-23 = <0x34>;
			pinctrl-24 = <0x35>;
			pinctrl-25 = <0x36>;
			pinctrl-26 = <0x37>;
			pinctrl-27 = <0x38>;
			pinctrl-28 = <0x39>;
			status = "okay";
		};
	};

	fragment@28 {
		target = <0xffffffff>;

		__overlay__ {

			default {
				linux,phandle = <0x3a>;
				phandle = <0x3a>;
			};

			hwen_high {
				linux,phandle = <0x3b>;
				phandle = <0x3b>;

				pins_cmd_dat {
					pinmux = <0x9700>;
					slew-rate = <0x01>;
					output-high;
				};
			};

			hwen_low {
				linux,phandle = <0x3c>;
				phandle = <0x3c>;

				pins_cmd_dat {
					pinmux = <0x9700>;
					slew-rate = <0x01>;
					output-low;
				};
			};

			strobe_high {
				linux,phandle = <0x3d>;
				phandle = <0x3d>;

				pins_cmd_dat {
					pinmux = <0x9600>;
					slew-rate = <0x01>;
					output-high;
				};
			};

			strobe_low {
				linux,phandle = <0x3e>;
				phandle = <0x3e>;

				pins_cmd_dat {
					pinmux = <0x9600>;
					slew-rate = <0x01>;
					output-low;
				};
			};
		};
	};

	fragment@29 {
		target = <0xffffffff>;

		__overlay__ {
			pinctrl-names = "default\0hwen_high\0hwen_low\0strobe_high\0strobe_low";
			pinctrl-0 = <0x3a>;
			pinctrl-1 = <0x3b>;
			pinctrl-2 = <0x3c>;
			pinctrl-3 = <0x3d>;
			pinctrl-4 = <0x3e>;
			status = "okay";
		};
	};

	fragment@30 {
		target = <0xffffffff>;

		__overlay__ {

			fpsensor_spi_default {
				linux,phandle = <0x3f>;
				phandle = <0x3f>;
			};

			fpsensor_spi_cs_low {
				linux,phandle = <0x40>;
				phandle = <0x40>;

				pins_cmd_dat {
					pinmux = <0x1a01>;
					slew-rate = <0x01>;
					output-low;
				};
			};

			fpsensor_spi_cs_high {
				linux,phandle = <0x41>;
				phandle = <0x41>;

				pins_cmd_dat {
					pinmux = <0x1a01>;
					slew-rate = <0x01>;
					output-high;
				};
			};

			fpsensor_spi_mi_low {
				linux,phandle = <0x42>;
				phandle = <0x42>;

				pins_cmd_dat {
					pinmux = <0x1901>;
					slew-rate = <0x00>;
					bias-pull-up = <0x00>;
				};
			};

			fpsensor_spi_mi_high {
				linux,phandle = <0x43>;
				phandle = <0x43>;

				pins_cmd_dat {
					pinmux = <0x1901>;
					bias-disable;
				};
			};

			fpsensor_spi_mo_low {
				linux,phandle = <0x44>;
				phandle = <0x44>;

				pins_cmd_dat {
					pinmux = <0x1b01>;
					slew-rate = <0x01>;
					output-low;
				};
			};

			fpsensor_spi_mo_high {
				linux,phandle = <0x45>;
				phandle = <0x45>;

				pins_cmd_dat {
					pinmux = <0x1b01>;
					slew-rate = <0x01>;
					output-high;
				};
			};

			fpsensor_spi_mclk_low {
				linux,phandle = <0x46>;
				phandle = <0x46>;

				pins_cmd_dat {
					pinmux = <0x1c01>;
					slew-rate = <0x01>;
					output-low;
				};
			};

			fpsensor_spi_mclk_high {
				linux,phandle = <0x47>;
				phandle = <0x47>;

				pins_cmd_dat {
					pinmux = <0x1c01>;
					slew-rate = <0x01>;
					output-high;
				};
			};

			fpsensor_finger_rst_low {
				linux,phandle = <0x48>;
				phandle = <0x48>;

				pins_cmd_dat {
					pinmux = <0x1600>;
					slew-rate = <0x01>;
					output-low;
				};
			};

			fpsensor_finger_rst_high {
				linux,phandle = <0x49>;
				phandle = <0x49>;

				pins_cmd_dat {
					pinmux = <0x1600>;
					slew-rate = <0x01>;
					output-high;
				};
			};

			fpsensor_finger_power_low {
				linux,phandle = <0x4a>;
				phandle = <0x4a>;
			};

			fpsensor_finger_power_high {
				linux,phandle = <0x4b>;
				phandle = <0x4b>;
			};

			fpsensor_eint_as_int {
				linux,phandle = <0x4c>;
				phandle = <0x4c>;

				pins_cmd_dat {
					pinmux = <0x500>;
					slew-rate = <0x00>;
					bias-pull-down = <0x00>;
				};
			};

			fpsensor_eint_in_low {
				linux,phandle = <0x4d>;
				phandle = <0x4d>;

				pins_cmd_dat {
					pinmux = <0x500>;
					slew-rate = <0x00>;
					bias-pull-down = <0x00>;
				};
			};

			fpsensor_eint_in_float {
				linux,phandle = <0x4e>;
				phandle = <0x4e>;

				pins_cmd_dat {
					pinmux = <0x500>;
					slew-rate = <0x00>;
					bias-disable;
				};
			};

			fpsensor_finger_cs_low {
				linux,phandle = <0x4f>;
				phandle = <0x4f>;

				pins_cmd_dat {
					pinmux = <0x1a01>;
					slew-rate = <0x01>;
					output-low;
					input-schmitt-enable = <0x00>;
				};
			};

			fpsensor_finger_cs_high {
				linux,phandle = <0x50>;
				phandle = <0x50>;

				pins_cmd_dat {
					pinmux = <0x1a01>;
					slew-rate = <0x01>;
					output-high;
					input-schmitt-enable = <0x00>;
				};
			};
		};
	};

	fragment@31 {
		target = <0xffffffff>;

		__overlay__ {
			pinctrl-names = "fpsensor_spi_default\0fpsensor_spi_cs_low\0fpsensor_spi_cs_high\0fpsensor_spi_mi_low\0fpsensor_spi_mi_high\0fpsensor_spi_mo_low\0fpsensor_spi_mo_high\0fpsensor_spi_mclk_low\0fpsensor_spi_mclk_high\0fpsensor_finger_rst_low\0fpsensor_finger_rst_high\0fpsensor_finger_power_low\0fpsensor_finger_power_high\0fpsensor_eint_as_int\0fpsensor_eint_in_low\0fpsensor_eint_in_float\0fpsensor_finger_cs_low\0fpsensor_finger_cs_high";
			pinctrl-0 = <0x3f>;
			pinctrl-1 = <0x40>;
			pinctrl-2 = <0x41>;
			pinctrl-3 = <0x42>;
			pinctrl-4 = <0x43>;
			pinctrl-5 = <0x44>;
			pinctrl-6 = <0x45>;
			pinctrl-7 = <0x46>;
			pinctrl-8 = <0x47>;
			pinctrl-9 = <0x48>;
			pinctrl-10 = <0x49>;
			pinctrl-11 = <0x4a>;
			pinctrl-12 = <0x4b>;
			pinctrl-13 = <0x4c>;
			pinctrl-14 = <0x4d>;
			pinctrl-15 = <0x4e>;
			pinctrl-16 = <0x4f>;
			pinctrl-17 = <0x50>;
			status = "okay";
		};
	};

	fragment@32 {
		target = <0xffffffff>;

		__overlay__ {
			u2_vrt_ref = <0x07>;
			u2_term_ref = <0x06>;
			u2_host_vrt_ref = <0x04>;
			u2_host_term_ref = <0x04>;
			status = "okay";
		};
	};

	fragment@33 {
		target = <0xffffffff>;

		__overlay__ {
			battery_cv = <0x432380>;
			jeita_temp_above_t4_cv = <0x401640>;
			jeita_temp_t3_to_t4_cv = <0x401640>;
			jeita_temp_t2_to_t3_cv = <0x432380>;
			jeita_temp_t1_to_t2_cv = <0x432380>;
			jeita_temp_t0_to_t1_cv = <0x432380>;
			jeita_temp_below_t0_cv = <0x401640>;
			temp_t4_thres = <0x37>;
			temp_t4_thres_minus_x_degree = <0x34>;
			temp_t3_thres = <0x2d>;
			temp_t3_thres_minus_x_degree = <0x27>;
			temp_t2_thres = <0x0f>;
			temp_t2_thres_plus_x_degree = <0x12>;
			temp_t1_thres = <0x0f>;
			temp_t1_thres_plus_x_degree = <0x12>;
			temp_t0_thres = <0x00>;
			temp_t0_thres_plus_x_degree = <0x02>;
			temp_neg_10_thres = <0x00>;
			enable_min_charge_temp;
			min_charge_temp = <0x00>;
			min_charge_temp_plus_x_degree = <0x02>;
			max_charge_temp = <0x37>;
			max_charge_temp_minus_x_degree = <0x34>;
			ac_charger_current = <0x1f47d0>;
		};
	};

	fragment@34 {
		target = <0xffffffff>;

		__overlay__ {
			TEMPERATURE_T0 = <0x32>;
			TEMPERATURE_T1 = <0x19>;
			TEMPERATURE_T2 = <0x00>;
			TEMPERATURE_T3 = <0xfffffff6>;
			g_FG_PSEUDO100_T0 = <0x61>;
			g_FG_PSEUDO100_T1 = <0x61>;
			g_FG_PSEUDO100_T2 = <0x5f>;
			g_FG_PSEUDO100_T3 = <0x5a>;
		};
	};

	fragment@35 {
		target = <0xffffffff>;

		__overlay__ {
			battery_total_number = <0x02>;
			battery0_name = "KS40-Sunwoda-2820mAh";
			battery1_name = "KS40-ATL-2820mAh";
			battery0_profile_t0_num = <0x64>;
			battery0_profile_t0 = <0x00 0xaa82 0x564 0x12f 0xa9fd 0x564 0x25d 0xa97a 0x564 0x38c 0xa8fb 0x564 0x4ba 0xa880 0x564 0x5e9 0xa807 0x564 0x717 0xa788 0x564 0x846 0xa70b 0x564 0x975 0xa692 0x564 0xaa3 0xa615 0x564 0xbd2 0xa597 0x565 0xd00 0xa524 0x571 0xe2f 0xa4ae 0x578 0xf5d 0xa435 0x578 0x108c 0xa3c1 0x578 0x11bb 0xa34d 0x578 0x12e9 0xa2d4 0x578 0x1418 0xa25e 0x578 0x1546 0xa1eb 0x578 0x1675 0xa178 0x578 0x17a4 0xa106 0x578 0x18d2 0xa099 0x578 0x1a01 0xa02c 0x581 0x1b2f 0x9fbf 0x593 0x1c5e 0x9f58 0x5a0 0x1d8c 0x9ef1 0x5aa 0x1ebb 0x9e8a 0x5aa 0x1fea 0x9e23 0x5aa 0x2118 0x9dbc 0x5aa 0x2247 0x9d5b 0x5ba 0x2375 0x9cfa 0x5cb 0x24a4 0x9c99 0x5d7 0x25d2 0x9c40 0x5e7 0x2701 0x9beb 0x5f9 0x2830 0x9b91 0x5fa 0x295e 0x9b39 0x606 0x2a8d 0x9aeb 0x631 0x2bbb 0x9a98 0x64c 0x2cea 0x9a44 0x65e 0x2e18 0x99e9 0x66a 0x2f47 0x9988 0x668 0x3076 0x991b 0x64a 0x31a4 0x989e 0x5fb 0x32d3 0x981a 0x595 0x3401 0x97b9 0x577 0x3530 0x9761 0x564 0x365e 0x9719 0x564 0x378d 0x96d4 0x557 0x38bc 0x9693 0x547 0x39ea 0x965c 0x559 0x3b19 0x9626 0x564 0x3c47 0x95ef 0x564 0x3d76 0x95bd 0x564 0x3ea5 0x958e 0x565 0x3fd3 0x9563 0x571 0x4102 0x9539 0x578 0x4230 0x950f 0x578 0x435f 0x94e4 0x578 0x448d 0x94bb 0x57b 0x45bc 0x9496 0x58d 0x46eb 0x9475 0x59c 0x4819 0x9457 0x5a8 0x4948 0x9439 0x5b9 0x4a76 0x941a 0x5c8 0x4ba5 0x93fc 0x5c8 0x4cd3 0x93de 0x5ce 0x4e02 0x93c0 0x5db 0x4f31 0x93a1 0x5dc 0x505f 0x937e 0x5d5 0x518e 0x9347 0x5b7 0x52bc 0x9306 0x592 0x53eb 0x92be 0x567 0x5519 0x9291 0x56f 0x5648 0x9267 0x578 0x5777 0x923c 0x578 0x58a5 0x9212 0x571 0x59d4 0x91e8 0x564 0x5b02 0x91c3 0x564 0x5c31 0x91a1 0x56d 0x5d5f 0x9182 0x58c 0x5e8e 0x9154 0x58a 0x5fbd 0x911e 0x578 0x60eb 0x90e1 0x578 0x621a 0x90a7 0x57e 0x6348 0x9070 0x591 0x6477 0x9029 0x589 0x65a6 0x8fdd 0x578 0x66d4 0x8fc5 0x578 0x6803 0x8fb4 0x58b 0x6931 0x8fae 0x5bb 0x6a60 0x8f9a 0x5de 0x6b8e 0x8f7b 0x5fd 0x6cbd 0x8f1b 0x61b 0x6dec 0x8e33 0x624 0x6f1a 0x8c9e 0x612 0x7049 0x8a55 0x655 0x7177 0x878c 0x6d9 0x72a6 0x82ba 0x875 0x73d4 0x8034 0x94c 0x7503 0x8034 0x94c>;
			battery0_profile_t1_num = <0x64>;
			battery0_profile_t1 = <0x00 0xab27 0x7ee 0x12f 0xaa87 0x7ee 0x25d 0xa9f1 0x7f4 0x38c 0xa96c 0x806 0x4ba 0xa8e8 0x80c 0x5e9 0xa865 0x80c 0x717 0xa7e7 0x806 0x846 0xa769 0x800 0x975 0xa6ec 0x7fa 0xaa3 0xa672 0x7fc 0xbd2 0xa5fa 0x801 0xd00 0xa580 0x7fb 0xe2f 0xa507 0x7f5 0xf5d 0xa48e 0x7ef 0x108c 0xa419 0x7f3 0x11bb 0xa3a5 0x7f8 0x12e9 0xa331 0x7f8 0x1418 0xa2bf 0x7fb 0x1546 0xa24e 0x801 0x1675 0xa1dc 0x802 0x17a4 0xa16a 0x803 0x18d2 0xa0fb 0x809 0x1a01 0xa08d 0x80f 0x1b2f 0xa01e 0x815 0x1c5e 0x9fb9 0x816 0x1d8c 0x9f5d 0x825 0x1ebb 0x9f19 0x86e 0x1fea 0x9ec4 0x8a9 0x2118 0x9e63 0x8da 0x2247 0x9dbb 0x897 0x2375 0x9d14 0x85a 0x24a4 0x9c84 0x854 0x25d2 0x9c16 0x861 0x2701 0x9bbd 0x879 0x2830 0x9b85 0x8ae 0x295e 0x9b4c 0x8db 0x2a8d 0x9b0d 0x8f3 0x2bbb 0x9ac3 0x8f8 0x2cea 0x9a74 0x8f2 0x2e18 0x9a1a 0x8e6 0x2f47 0x99bb 0x8c9 0x3076 0x994f 0x88d 0x31a4 0x98de 0x844 0x32d3 0x986a 0x7f6 0x3401 0x9801 0x7b3 0x3530 0x97a0 0x781 0x365e 0x974e 0x769 0x378d 0x9704 0x750 0x38bc 0x96bd 0x73a 0x39ea 0x9683 0x741 0x3b19 0x964b 0x744 0x3c47 0x9614 0x744 0x3d76 0x95e2 0x74d 0x3ea5 0x95b1 0x758 0x3fd3 0x9583 0x758 0x4102 0x9557 0x75e 0x4230 0x952e 0x76a 0x435f 0x9505 0x771 0x448d 0x94de 0x777 0x45bc 0x94b8 0x77d 0x46eb 0x9495 0x789 0x4819 0x9474 0x79b 0x4948 0x9455 0x79e 0x4a76 0x9437 0x7a0 0x4ba5 0x9419 0x7ad 0x4cd3 0x93fe 0x7bc 0x4e02 0x93e5 0x7ce 0x4f31 0x93ca 0x7c5 0x505f 0x93ad 0x7ba 0x518e 0x938f 0x7b4 0x52bc 0x9372 0x7b6 0x53eb 0x9357 0x7bc 0x5519 0x9335 0x7ab 0x5648 0x9312 0x79c 0x5777 0x92ed 0x796 0x58a5 0x92c5 0x798 0x59d4 0x929c 0x79e 0x5b02 0x9275 0x7aa 0x5c31 0x9252 0x7c0 0x5d5f 0x9234 0x7ea 0x5e8e 0x920b 0x80d 0x5fbd 0x91db 0x82b 0x60eb 0x919c 0x83d 0x621a 0x9160 0x858 0x6348 0x9129 0x882 0x6477 0x90e5 0x8ad 0x65a6 0x909d 0x8d7 0x66d4 0x905f 0x8fb 0x6803 0x9035 0x936 0x6931 0x9028 0x991 0x6a60 0x9018 0xa03 0x6b8e 0x9004 0xa83 0x6cbd 0x8fd9 0xb3f 0x6dec 0x8f4d 0xbe1 0x6f1a 0x8e50 0xc67 0x7049 0x8c63 0xd66 0x7177 0x89ff 0xebe 0x72a6 0x8649 0x1158 0x73d4 0x8472 0x12a2 0x7503 0x8472 0x12a2>;
			battery0_profile_t2_num = <0x64>;
			battery0_profile_t2 = <0x00 0xab46 0x1fb8 0x12f 0xaa72 0x1fb8 0x25d 0xa9aa 0x1fba 0x38c 0xa8fa 0x1fc0 0x4ba 0xa858 0x1fa5 0x5e9 0xa7bd 0x1f7a 0x717 0xa730 0x1f50 0x846 0xa6a5 0x1f1c 0x975 0xa61e 0x1ed9 0xaa3 0xa59b 0x1ea4 0xbd2 0xa51a 0x1e75 0xd00 0xa49e 0x1e51 0xe2f 0xa425 0x1e27 0xf5d 0xa3af 0x1df7 0x108c 0xa33c 0x1dc6 0x11bb 0xa2c9 0x1d98 0x12e9 0xa257 0x1d7a 0x1418 0xa1e5 0x1d59 0x1546 0xa172 0x1d34 0x1675 0xa103 0x1d15 0x17a4 0xa099 0x1d00 0x18d2 0xa048 0x1d18 0x1a01 0x9ff6 0x1d46 0x1b2f 0x9fa4 0x1d89 0x1c5e 0x9f34 0x1d78 0x1d8c 0x9eb6 0x1d44 0x1ebb 0x9e13 0x1cbf 0x1fea 0x9d6a 0x1c2c 0x2118 0x9cbe 0x1b8e 0x2247 0x9c32 0x1b39 0x2375 0x9bb0 0x1af6 0x24a4 0x9b43 0x1ad8 0x25d2 0x9ae7 0x1acc 0x2701 0x9a96 0x1acc 0x2830 0x9a4d 0x1add 0x295e 0x9a02 0x1ae3 0x2a8d 0x99b1 0x1acb 0x2bbb 0x995e 0x1ab2 0x2cea 0x990a 0x1a9a 0x2e18 0x98b5 0x1a70 0x2f47 0x9861 0x1a4c 0x3076 0x980f 0x1a34 0x31a4 0x97c0 0x1a20 0x32d3 0x9773 0x1a0e 0x3401 0x972a 0x1a0e 0x3530 0x96e2 0x1a0c 0x365e 0x969d 0x1a06 0x378d 0x9660 0x1a16 0x38bc 0x9626 0x1a2e 0x39ea 0x95ed 0x1a46 0x3b19 0x95b7 0x1a61 0x3c47 0x9585 0x1a7f 0x3d76 0x9555 0x1a99 0x3ea5 0x9527 0x1ab3 0x3fd3 0x94fb 0x1add 0x4102 0x94d1 0x1b08 0x4230 0x94a8 0x1b32 0x435f 0x9486 0x1b61 0x448d 0x9468 0x1b95 0x45bc 0x944f 0x1bd7 0x46eb 0x9439 0x1c29 0x4819 0x9427 0x1c8a 0x4948 0x9415 0x1cfb 0x4a76 0x9405 0x1d70 0x4ba5 0x93f4 0x1def 0x4cd3 0x93e4 0x1e75 0x4e02 0x93d5 0x1f00 0x4f31 0x93c6 0x1f9c 0x505f 0x93b6 0x203e 0x518e 0x93a1 0x20ed 0x52bc 0x938e 0x21a4 0x53eb 0x937b 0x225f 0x5519 0x9365 0x2326 0x5648 0x934e 0x23f3 0x5777 0x9335 0x24cd 0x58a5 0x9318 0x25a7 0x59d4 0x92f8 0x2681 0x5b02 0x92d7 0x2773 0x5c31 0x92b3 0x2867 0x5d5f 0x928c 0x295f 0x5e8e 0x925f 0x2a63 0x5fbd 0x922f 0x2b6e 0x60eb 0x91f9 0x2c8b 0x621a 0x91c1 0x2dbb 0x6348 0x9187 0x2f0e 0x6477 0x9148 0x3061 0x65a6 0x9106 0x31b6 0x66d4 0x90c2 0x3327 0x6803 0x9086 0x349e 0x6931 0x9055 0x361b 0x6a60 0x9033 0x37c6 0x6b8e 0x9015 0x3986 0x6cbd 0x8fef 0x3b70 0x6dec 0x8fb0 0x3d62 0x6f1a 0x8f52 0x3f5f 0x7049 0x8e2f 0x4156 0x7177 0x8cab 0x439b 0x72a6 0x8a1b 0x4787 0x73d4 0x86b8 0x4bbe 0x7503 0x817b 0x45ce>;
			battery0_profile_t3_num = <0x64>;
			battery0_profile_t3 = <0x00 0xab5e 0x402e 0x12f 0xaa4e 0x402e 0x25d 0xa94a 0x3fc5 0x38c 0xa85e 0x3e97 0x4ba 0xa790 0x3d53 0x5e9 0xa6cf 0x3c07 0x717 0xa620 0x3ac6 0x846 0xa577 0x3994 0x975 0xa4da 0x3878 0xaa3 0xa44e 0x3791 0xbd2 0xa3c9 0x36bd 0xd00 0xa344 0x35e9 0xe2f 0xa2c2 0x351b 0xf5d 0xa243 0x3453 0x108c 0xa1c8 0x33b1 0x11bb 0xa154 0x3325 0x12e9 0xa0ff 0x32e8 0x1418 0xa0a5 0x32ac 0x1546 0xa044 0x326f 0x1675 0x9fc6 0x3202 0x17a4 0x9f3a 0x3175 0x18d2 0x9e8a 0x3083 0x1a01 0x9de1 0x2fa1 0x1b2f 0x9d3e 0x2ecd 0x1c5e 0x9cb4 0x2e3c 0x1d8c 0x9c34 0x2dc0 0x1ebb 0x9bc7 0x2d65 0x1fea 0x9b64 0x2d22 0x2118 0x9b0a 0x2cf1 0x2247 0x9aba 0x2ce1 0x2375 0x9a6b 0x2cd8 0x24a4 0x9a1d 0x2cd8 0x25d2 0x99ce 0x2cc6 0x2701 0x997f 0x2ca8 0x2830 0x992b 0x2c8a 0x295e 0x98da 0x2c6f 0x2a8d 0x9891 0x2c5d 0x2bbb 0x9845 0x2c4e 0x2cea 0x97f6 0x2c42 0x2e18 0x97ae 0x2c42 0x2f47 0x9767 0x2c3c 0x3076 0x9724 0x2c2a 0x31a4 0x96de 0x2c24 0x32d3 0x9695 0x2c24 0x3401 0x965f 0x2c36 0x3530 0x9629 0x2c46 0x365e 0x95f2 0x2c52 0x378d 0x95c0 0x2c6b 0x38bc 0x9590 0x2c8a 0x39ea 0x9566 0x2cbb 0x3b19 0x953e 0x2ce9 0x3c47 0x9519 0x2d13 0x3d76 0x94fa 0x2d58 0x3ea5 0x94dc 0x2da8 0x3fd3 0x94c4 0x2e03 0x4102 0x94ac 0x2e63 0x4230 0x9493 0x2ec9 0x435f 0x9480 0x2f3e 0x448d 0x946e 0x2fbb 0x45bc 0x945c 0x3052 0x46eb 0x9447 0x30e4 0x4819 0x942e 0x316f 0x4948 0x941b 0x320e 0x4a76 0x9408 0x32b4 0x4ba5 0x93f0 0x336a 0x4cd3 0x93db 0x341f 0x4e02 0x93c9 0x34d5 0x4f31 0x93b1 0x359a 0x505f 0x9399 0x3660 0x518e 0x9381 0x3722 0x52bc 0x9365 0x37dd 0x53eb 0x9347 0x3892 0x5519 0x932e 0x3963 0x5648 0x9314 0x3a34 0x5777 0x92f6 0x3afc 0x58a5 0x92d8 0x3bd2 0x59d4 0x92ba 0x3cb2 0x5b02 0x9296 0x3d86 0x5c31 0x9270 0x3e5a 0x5d5f 0x9245 0x3f2d 0x5e8e 0x9217 0x4001 0x5fbd 0x91e7 0x40d5 0x60eb 0x91b0 0x419c 0x621a 0x917a 0x4276 0x6348 0x9144 0x4374 0x6477 0x910d 0x448b 0x65a6 0x90d7 0x45ae 0x66d4 0x90ad 0x46fb 0x6803 0x9085 0x486e 0x6931 0x9060 0x4a21 0x6a60 0x9038 0x4c23 0x6b8e 0x900b 0x4e4d 0x6cbd 0x8fc3 0x5105 0x6dec 0x8f4b 0x53f6 0x6f1a 0x8e8f 0x5739 0x7049 0x8d2d 0x5b78 0x7177 0x8b82 0x5edf 0x72a6 0x88ff 0x5897 0x73d4 0x850c 0x4ebc 0x7503 0x844e 0x4ce0>;
			battery1_profile_t0_num = <0x64>;
			battery1_profile_t0 = <0x00 0xaa82 0x5aa 0x12f 0xa9ea 0x5aa 0x25e 0xa95d 0x5aa 0x38d 0xa8d8 0x5a7 0x4bc 0xa857 0x5a0 0x5ec 0xa7d6 0x5a0 0x71b 0xa75b 0x5a5 0x84a 0xa6de 0x5a7 0x979 0xa65e 0x5a1 0xaa8 0xa5e5 0x5a8 0xbd7 0xa571 0x5aa 0xd06 0xa4fc 0x5ad 0xe35 0xa483 0x5b6 0xf64 0xa40a 0x5c5 0x1094 0xa397 0x5c2 0x11c3 0xa321 0x5c2 0x12f2 0xa2a9 0x5c8 0x1421 0xa238 0x5c8 0x1550 0xa1c6 0x5c8 0x167f 0xa154 0x5cc 0x17ae 0xa0e4 0x5d5 0x18dd 0xa07a 0x5e4 0x1a0c 0xa009 0x5e6 0x1b3c 0x9f9c 0x5ea 0x1c6b 0x9f34 0x5f0 0x1d9a 0x9ed1 0x5f0 0x1ec9 0x9e68 0x5fe 0x1ff8 0x9e02 0x60d 0x2127 0x9da0 0x616 0x2256 0x9d3d 0x60e 0x2385 0x9cdb 0x615 0x24b4 0x9c7d 0x622 0x25e3 0x9c25 0x62e 0x2713 0x9bd1 0x636 0x2842 0x9b7e 0x645 0x2971 0x9b2a 0x654 0x2aa0 0x9ad7 0x666 0x2bcf 0x9a84 0x67d 0x2cfe 0x9a38 0x694 0x2e2d 0x99e7 0x6a5 0x2f5c 0x9994 0x6b4 0x308b 0x993e 0x6bf 0x31bb 0x98d4 0x6a1 0x32ea 0x9858 0x65a 0x3419 0x97de 0x611 0x3548 0x9771 0x5da 0x3677 0x971d 0x5cb 0x37a6 0x96d6 0x5bc 0x38d5 0x9696 0x5b4 0x3a04 0x965b 0x5b4 0x3b33 0x9626 0x5b4 0x3c63 0x95f1 0x5ba 0x3d92 0x95c0 0x5ba 0x3ec1 0x9592 0x5b7 0x3ff0 0x9565 0x5c6 0x411f 0x9537 0x5c8 0x424e 0x950a 0x5cc 0x437d 0x94de 0x5d4 0x44ac 0x94b8 0x5dc 0x45db 0x949a 0x5e3 0x470b 0x9477 0x5eb 0x483a 0x9453 0x5f2 0x4969 0x9435 0x5fa 0x4a98 0x9416 0x601 0x4bc7 0x93f8 0x60e 0x4cf6 0x93dc 0x618 0x4e25 0x93c5 0x618 0x4f54 0x93a7 0x627 0x5083 0x9389 0x631 0x51b3 0x9362 0x625 0x52e2 0x932b 0x5f7 0x5411 0x92e0 0x5c2 0x5540 0x92aa 0x5ba 0x566f 0x927d 0x5be 0x579e 0x9250 0x5bf 0x58cd 0x922a 0x5c6 0x59fc 0x9204 0x5c2 0x5b2b 0x91de 0x5c2 0x5c5a 0x91ba 0x5c9 0x5d8a 0x919b 0x5d1 0x5eb9 0x9177 0x5d8 0x5fe8 0x9145 0x5d8 0x6117 0x9109 0x5d1 0x6246 0x90cc 0x5c9 0x6375 0x9090 0x5d5 0x64a4 0x904b 0x5dc 0x65d3 0x9002 0x5d3 0x6702 0x8fc6 0x5ae 0x6832 0x8fb9 0x5bf 0x6961 0x8fad 0x5da 0x6a90 0x8f9e 0x5fc 0x6bbf 0x8f8f 0x62a 0x6cee 0x8f6a 0x66d 0x6e1d 0x8ed7 0x65b 0x6f4c 0x8db8 0x63a 0x707b 0x8bf1 0x668 0x71aa 0x8967 0x6ba 0x72da 0x85ce 0x77e 0x7409 0x8322 0x820 0x7538 0x8322 0x820>;
			battery1_profile_t1_num = <0x64>;
			battery1_profile_t1 = <0x00 0xab18 0x6c2 0x12f 0xaa80 0x6c2 0x25e 0xa9f3 0x6c2 0x38d 0xa96e 0x6bd 0x4bc 0xa8ed 0x6af 0x5ec 0xa86c 0x6be 0x71b 0xa7f1 0x6c7 0x84a 0xa774 0x6c9 0x979 0xa6f4 0x6c2 0xaa8 0xa67b 0x6c2 0xbd7 0xa602 0x6ce 0xd06 0xa589 0x6d6 0xe35 0xa50f 0x6d8 0xf64 0xa496 0x6e7 0x1094 0xa41d 0x6e4 0x11c3 0xa3a7 0x6e0 0x12f2 0xa336 0x6e1 0x1421 0xa2c4 0x6e9 0x1550 0xa253 0x6f7 0x167f 0xa1e1 0x706 0x17ae 0xa16f 0x714 0x18dd 0xa0fe 0x71b 0x1a0c 0xa08c 0x729 0x1b3c 0xa01f 0x730 0x1c6b 0x9fb6 0x735 0x1d9a 0x9f54 0x74c 0x1ec9 0x9ef8 0x76a 0x1ff8 0x9e94 0x788 0x2127 0x9e28 0x79e 0x2256 0x9db7 0x79e 0x2385 0x9d45 0x7b4 0x24b4 0x9cdd 0x7bc 0x25e3 0x9c7a 0x7c3 0x2713 0x9c18 0x7da 0x2842 0x9bbd 0x7e2 0x2971 0x9b67 0x7e9 0x2aa0 0x9b19 0x7f9 0x2bcf 0x9ad5 0x816 0x2cfe 0x9a89 0x81e 0x2e2d 0x9a33 0x820 0x2f5c 0x99d8 0x814 0x308b 0x997b 0x7f3 0x31bb 0x9909 0x7ae 0x32ea 0x9898 0x764 0x3419 0x9829 0x719 0x3548 0x97c2 0x6d1 0x3677 0x976f 0x6ac 0x37a6 0x9721 0x692 0x38d5 0x96dd 0x686 0x3a04 0x96a0 0x686 0x3b33 0x9664 0x686 0x3c63 0x962d 0x680 0x3d92 0x95fc 0x67c 0x3ec1 0x95cf 0x67e 0x3ff0 0x95a1 0x685 0x411f 0x9574 0x68d 0x424e 0x954b 0x694 0x437d 0x9525 0x69c 0x44ac 0x94ff 0x6a3 0x45db 0x94d9 0x6a4 0x470b 0x94b8 0x6a9 0x483a 0x9499 0x6ae 0x4969 0x947b 0x6ae 0x4a98 0x945d 0x6b5 0x4bc7 0x943f 0x6b3 0x4cf6 0x9420 0x6b0 0x4e25 0x9402 0x6b8 0x4f54 0x93eb 0x6c0 0x5083 0x93d5 0x6c7 0x51b3 0x93bb 0x6c9 0x52e2 0x939d 0x6c1 0x5411 0x937e 0x6b2 0x5540 0x9360 0x69e 0x566f 0x9342 0x68a 0x579e 0x9323 0x67b 0x58cd 0x92fd 0x674 0x59fc 0x92d7 0x66c 0x5b2b 0x92b1 0x668 0x5c5a 0x928c 0x669 0x5d8a 0x926e 0x670 0x5eb9 0x924a 0x678 0x5fe8 0x921d 0x67c 0x6117 0x91e5 0x67b 0x6246 0x91a1 0x673 0x6375 0x9169 0x67f 0x64a4 0x9130 0x68a 0x65d3 0x90ee 0x68d 0x6702 0x9093 0x67e 0x6832 0x906d 0x683 0x6961 0x905c 0x697 0x6a90 0x9052 0x6b9 0x6bbf 0x9043 0x6e6 0x6cee 0x9034 0x71b 0x6e1d 0x9001 0x754 0x6f4c 0x8f6f 0x773 0x707b 0x8e29 0x746 0x71aa 0x8c18 0x794 0x72da 0x894f 0x826 0x7409 0x8524 0x9a5 0x7538 0x7ed6 0xcd0>;
			battery1_profile_t2_num = <0x64>;
			battery1_profile_t2 = <0x00 0xab7c 0x1162 0x12f 0xaad5 0x1162 0x25e 0xaa43 0x115d 0x38d 0xa9be 0x1150 0x4bc 0xa93d 0x1138 0x5ec 0xa8bc 0x110b 0x71b 0xa83b 0x10d8 0x84a 0xa7bd 0x10af 0x979 0xa744 0x1098 0xaa8 0xa6cb 0x1081 0xbd7 0xa657 0x106b 0xd06 0xa5e2 0x1054 0xe35 0xa569 0x103e 0xf64 0xa4f0 0x102f 0x1094 0xa47d 0x1020 0x11c3 0xa40b 0x1018 0x12f2 0xa399 0x1017 0x1421 0xa328 0x100f 0x1550 0xa2b6 0x100e 0x167f 0xa244 0x100e 0x17ae 0xa1d3 0x100e 0x18dd 0xa161 0x100e 0x1a0c 0xa0ef 0x1007 0x1b3c 0xa082 0x1000 0x1c6b 0xa01a 0xffa 0x1d9a 0x9fb7 0xffa 0x1ec9 0x9f5c 0x102b 0x1ff8 0x9f01 0x106e 0x2127 0x9e9d 0x10a6 0x2256 0x9e24 0x10ae 0x2385 0x9d86 0x1065 0x24b4 0x9cec 0x102c 0x25e3 0x9c5c 0x1002 0x2713 0x9bdb 0xfdc 0x2842 0x9b79 0xfcd 0x2971 0x9b20 0xfb3 0x2aa0 0x9aca 0xf8a 0x2bcf 0x9a6f 0xf4c 0x2cfe 0x9a14 0xf00 0x2e2d 0x99ba 0xed0 0x2f5c 0x9962 0xeb1 0x308b 0x990e 0xe99 0x31bb 0x98b3 0xe73 0x32ea 0x985e 0xe53 0x3419 0x980a 0xe38 0x3548 0x97b9 0xe22 0x3677 0x9775 0xe13 0x37a6 0x9731 0xe10 0x38d5 0x96ec 0xe0c 0x3a04 0x96ab 0xe07 0x3b33 0x9676 0xe0f 0x3c63 0x963a 0xe16 0x3d92 0x9602 0xe26 0x3ec1 0x95ce 0xe38 0x3ff0 0x95a1 0xe38 0x411f 0x9573 0xe4c 0x424e 0x954a 0xe5a 0x437d 0x9522 0xe66 0x44ac 0x94f5 0xe7d 0x45db 0x94cf 0xe93 0x470b 0x94ad 0xeaa 0x483a 0x948d 0xebc 0x4969 0x9467 0xec4 0x4a98 0x9448 0xeda 0x4bc7 0x942a 0xef1 0x4cf6 0x940c 0xf03 0x4e25 0x93ee 0xf0b 0x4f54 0x93d7 0xf29 0x5083 0x93c5 0xf3d 0x51b3 0x93b3 0xf49 0x52e2 0x939d 0xf53 0x5411 0x938e 0xf80 0x5540 0x937f 0xf9d 0x566f 0x9370 0xfba 0x579e 0x9360 0xfe0 0x58cd 0x9349 0x1006 0x59fc 0x932c 0x102c 0x5b2b 0x930e 0x1055 0x5c5a 0x92f0 0x1085 0x5d8a 0x92d1 0x10c1 0x5eb9 0x92a7 0x1104 0x5fe8 0x9279 0x114c 0x6117 0x924a 0x1198 0x6246 0x9215 0x11e4 0x6375 0x91da 0x124a 0x64a4 0x919d 0x12bc 0x65d3 0x915b 0x1337 0x6702 0x9108 0x13b8 0x6832 0x90c9 0x1462 0x6961 0x909a 0x1533 0x6a90 0x9076 0x163a 0x6bbf 0x9058 0x178f 0x6cee 0x9039 0x1949 0x6e1d 0x9012 0x1b88 0x6f4c 0x8fc6 0x1e59 0x707b 0x8f36 0x21c8 0x71aa 0x8db7 0x2671 0x72da 0x8b93 0x2eb1 0x7409 0x889d 0x3b80 0x7538 0x84d0 0x4d08>;
			battery1_profile_t3_num = <0x64>;
			battery1_profile_t3 = <0x00 0xab9a 0x25a8 0x12f 0xaacd 0x25a8 0x25e 0xaa20 0x25a3 0x38d 0xa989 0x2585 0x4bc 0xa900 0x2540 0x5ec 0xa878 0x24e5 0x71b 0xa7f0 0x2495 0x84a 0xa76d 0x2443 0x979 0xa6f4 0x23ea 0xaa8 0xa67b 0x239e 0xbd7 0xa602 0x2347 0xd06 0xa588 0x22f2 0xe35 0xa50f 0x22a7 0xf64 0xa496 0x225b 0x1094 0xa41d 0x2215 0x11c3 0xa3a7 0x21d1 0x12f2 0xa335 0x218d 0x1421 0xa2c4 0x2149 0x1550 0xa252 0x210b 0x167f 0xa1dc 0x20ce 0x17ae 0xa165 0x2092 0x18dd 0xa0f3 0x2055 0x1a0c 0xa081 0x2018 0x1b3c 0xa014 0x1fed 0x1c6b 0x9fac 0x1fd6 0x1d9a 0x9f49 0x1fd6 0x1ec9 0x9ee0 0x1fcf 0x1ff8 0x9e6c 0x1fac 0x2127 0x9de8 0x1f67 0x2256 0x9d49 0x1efd 0x2385 0x9ca2 0x1e7d 0x24b4 0x9c06 0x1e10 0x25e3 0x9b76 0x1dbd 0x2713 0x9af5 0x1d88 0x2842 0x9a92 0x1d71 0x2971 0x9a40 0x1d6a 0x2aa0 0x99f4 0x1d5f 0x2bcf 0x99a8 0x1d40 0x2cfe 0x995c 0x1d1a 0x2e2d 0x9916 0x1d0a 0x2f5c 0x98d2 0x1d03 0x308b 0x988e 0x1cfa 0x31bb 0x9849 0x1ce3 0x32ea 0x97ff 0x1cd2 0x3419 0x97b7 0x1cca 0x3548 0x9773 0x1cca 0x3677 0x972f 0x1cca 0x37a6 0x96f1 0x1cd6 0x38d5 0x96b4 0x1ce2 0x3a04 0x9677 0x1cef 0x3b33 0x963b 0x1d15 0x3c63 0x9605 0x1d3a 0x3d92 0x95d0 0x1d58 0x3ec1 0x959c 0x1d71 0x3ff0 0x956f 0x1d8f 0x411f 0x9541 0x1dad 0x424e 0x9514 0x1dd0 0x437d 0x94e6 0x1df8 0x44ac 0x94b9 0x1e25 0x45db 0x9492 0x1e44 0x470b 0x946d 0x1e67 0x483a 0x9449 0x1e90 0x4969 0x942b 0x1ebd 0x4a98 0x940c 0x1ef9 0x4bc7 0x93f3 0x1f36 0x4cf6 0x93dc 0x1f75 0x4e25 0x93c6 0x1fba 0x4f54 0x93b7 0x200d 0x5083 0x93a2 0x206b 0x51b3 0x938b 0x20c8 0x52e2 0x9375 0x211d 0x5411 0x9366 0x218f 0x5540 0x9351 0x21f5 0x566f 0x9337 0x2261 0x579e 0x931a 0x22dc 0x58cd 0x9303 0x2364 0x59fc 0x92e6 0x23ff 0x5b2b 0x92c8 0x24a5 0x5c5a 0x92a9 0x2554 0x5d8a 0x9283 0x260a 0x5eb9 0x925d 0x26e5 0x5fe8 0x9233 0x27d8 0x6117 0x9206 0x28e2 0x6246 0x91d8 0x2a11 0x6375 0x919e 0x2b61 0x64a4 0x9165 0x2cec 0x65d3 0x9130 0x2ebf 0x6702 0x90fb 0x30f0 0x6832 0x90cd 0x339c 0x6961 0x90a4 0x36c9 0x6a90 0x907c 0x3a62 0x6bbf 0x904e 0x3e43 0x6cee 0x9013 0x4223 0x6e1d 0x8fc3 0x45c1 0x6f4c 0x8f4e 0x4972 0x707b 0x8ea0 0x4da7 0x71aa 0x8d4d 0x54aa 0x72da 0x8cdc 0x56fe 0x7409 0x8cdc 0x56fe 0x7538 0x8cdc 0x56fe>;
		};
	};

	fragment@36 {
		target = <0xffffffff>;

		__overlay__ {

			adc_channel@ {
				compatible = "mediatek,adc_channel";
				mediatek,temperature0 = <0x00>;
				mediatek,temperature1 = <0x01>;
				mediatek,usb_id = <0x02>;
				mediatek,batt_id = <0x03>;
				mediatek,temperature2 = <0x04>;
				status = "okay";
			};
		};
	};

	fragment@37 {
		target = <0xffffffff>;

		__overlay__ {
			mediatek,clkbuf-quantity = <0x07>;
			mediatek,clkbuf-config = <0x02 0x01 0x01 0x02 0x00 0x00 0x00>;
			mediatek,clkbuf-driving-current = <0x01 0x01 0x01 0x01 0x01 0x01 0x01>;
			status = "okay";
		};
	};

	fragment@38 {
		target = <0xffffffff>;

		__overlay__ {
			#address-cells = <0x01>;
			#size-cells = <0x00>;
			clock-frequency = <0x61a80>;
			mediatek,use-open-drain;
		};
	};

	fragment@39 {
		target = <0xffffffff>;

		__overlay__ {
			#address-cells = <0x01>;
			#size-cells = <0x00>;
			clock-frequency = <0x61a80>;
			mediatek,use-open-drain;

			sar@28 {
				compatible = "mediatek,sar";
				reg = <0x28>;
				status = "okay";
				interrupt-parent = <0xffffffff>;
				interrupts = <0x09 0x08 0x09 0x00>;
				linux,phandle = <0x5e>;
				phandle = <0x5e>;
			};

			alsps@46 {
				compatible = "mediatek,alsps";
				reg = <0x46>;
				status = "okay";
				interrupt-parent = <0xffffffff>;
				interrupts = <0x06 0x08 0x06 0x00>;
				linux,phandle = <0x5f>;
				phandle = <0x5f>;
			};
		};
	};

	fragment@40 {
		target = <0xffffffff>;

		__overlay__ {
			#address-cells = <0x01>;
			#size-cells = <0x00>;
			clock-frequency = <0x61a80>;
			mediatek,use-open-drain;

			camera_main_eeprom@50 {
				compatible = "mediatek,camera_main_eeprom";
				reg = <0x50>;
				status = "okay";
				linux,phandle = <0x60>;
				phandle = <0x60>;
			};

			camera_main@1a {
				compatible = "mediatek,camera_main";
				reg = <0x1a>;
				status = "okay";
				linux,phandle = <0x61>;
				phandle = <0x61>;
			};

			camera_main_af@0c {
				compatible = "mediatek,camera_main_af";
				reg = <0x0c>;
				status = "okay";
				linux,phandle = <0x62>;
				phandle = <0x62>;
			};
		};
	};

	fragment@41 {
		target = <0xffffffff>;

		__overlay__ {
			#address-cells = <0x01>;
			#size-cells = <0x00>;
			clock-frequency = <0x61a80>;
			mediatek,use-open-drain;
		};
	};

	fragment@42 {
		target = <0xffffffff>;

		__overlay__ {
			#address-cells = <0x01>;
			#size-cells = <0x00>;
			clock-frequency = <0x61a80>;
			mediatek,use-open-drain;

			camera_sub@2d {
				compatible = "mediatek,camera_sub";
				reg = <0x2d>;
				status = "okay";
				linux,phandle = <0x63>;
				phandle = <0x63>;
			};

			camera_main_two@2f {
				compatible = "mediatek,camera_main_two";
				reg = <0x2f>;
				status = "okay";
				linux,phandle = <0x64>;
				phandle = <0x64>;
			};
		};
	};

	fragment@43 {
		target = <0xffffffff>;

		__overlay__ {
			#address-cells = <0x01>;
			#size-cells = <0x00>;
			clock-frequency = <0x61a80>;
			mediatek,use-push-pull;
		};
	};

	fragment@44 {
		target = <0xffffffff>;

		__overlay__ {
			#address-cells = <0x01>;
			#size-cells = <0x00>;
			clock-frequency = <0x61a80>;
			mediatek,use-open-drain;

			strobe_main@63 {
				compatible = "mediatek,strobe_main";
				reg = <0x63>;
				status = "okay";
				linux,phandle = <0x65>;
				phandle = <0x65>;
			};
		};
	};

	fragment@45 {
		target = <0xffffffff>;

		__overlay__ {
			#address-cells = <0x01>;
			#size-cells = <0x00>;
			clock-frequency = <0x61a80>;
			mediatek,use-open-drain;
		};
	};

	fragment@46 {
		target = <0xffffffff>;

		__overlay__ {
			#address-cells = <0x01>;
			#size-cells = <0x00>;
			clock-frequency = <0x61a80>;
			mediatek,use-open-drain;
		};
	};

	fragment@47 {
		target = <0xffffffff>;

		__overlay__ {
			#address-cells = <0x01>;
			#size-cells = <0x00>;
			clock-frequency = <0x61a80>;
			mediatek,use-open-drain;
		};
	};

	fragment@48 {
		target = <0xffffffff>;

		__overlay__ {
			GPIO_SIM2_SIO = <0xffffffff 0x23 0x00>;
			GPIO_SIM2_SRST = <0xffffffff 0x24 0x00>;
			GPIO_SIM2_SCLK = <0xffffffff 0x25 0x00>;
			GPIO_SIM1_SCLK = <0xffffffff 0x26 0x00>;
			GPIO_SIM1_SRST = <0xffffffff 0x27 0x00>;
			GPIO_SIM1_SIO = <0xffffffff 0x28 0x00>;
			GPIO_SIM1_HOT_PLUG = <0xffffffff 0x2f 0x00>;
		};
	};

	fragment@49 {
		target = <0xffffffff>;

		__overlay__ {
			gpio_init_default = <0x00 0x00 0x00 0x00 0x01 0x01 0x01 0x01 0x00 0x00 0x00 0x01 0x01 0x01 0x02 0x00 0x00 0x00 0x01 0x01 0x01 0x03 0x00 0x00 0x00 0x01 0x00 0x01 0x04 0x00 0x00 0x00 0x01 0x00 0x00 0x05 0x00 0x00 0x00 0x01 0x01 0x00 0x06 0x00 0x00 0x00 0x01 0x01 0x00 0x07 0x00 0x00 0x00 0x01 0x00 0x00 0x08 0x07 0x00 0x00 0x01 0x01 0x00 0x09 0x00 0x00 0x00 0x01 0x01 0x00 0x0a 0x00 0x00 0x00 0x01 0x00 0x00 0x0b 0x00 0x00 0x00 0x01 0x01 0x00 0x0c 0x00 0x00 0x00 0x01 0x01 0x00 0x0d 0x03 0x00 0x00 0x01 0x00 0x00 0x0e 0x03 0x01 0x00 0x00 0x00 0x00 0x0f 0x03 0x01 0x00 0x00 0x00 0x00 0x10 0x03 0x01 0x00 0x01 0x01 0x00 0x11 0x00 0x00 0x00 0x01 0x00 0x00 0x12 0x00 0x00 0x00 0x01 0x00 0x00 0x13 0x00 0x00 0x00 0x01 0x00 0x00 0x14 0x00 0x00 0x00 0x01 0x00 0x00 0x15 0x00 0x01 0x00 0x01 0x00 0x00 0x16 0x00 0x01 0x01 0x01 0x01 0x00 0x17 0x00 0x00 0x00 0x00 0x00 0x00 0x18 0x00 0x01 0x00 0x00 0x00 0x00 0x19 0x01 0x00 0x00 0x01 0x01 0x00 0x1a 0x01 0x01 0x01 0x00 0x00 0x00 0x1b 0x01 0x01 0x00 0x00 0x00 0x00 0x1c 0x01 0x01 0x00 0x01 0x01 0x00 0x1d 0x01 0x01 0x00 0x00 0x00 0x01 0x1e 0x01 0x00 0x00 0x01 0x01 0x01 0x1f 0x01 0x00 0x00 0x01 0x01 0x01 0x20 0x01 0x00 0x00 0x01 0x01 0x01 0x21 0x01 0x00 0x00 0x01 0x01 0x01 0x22 0x01 0x00 0x00 0x01 0x01 0x01 0x23 0x01 0x00 0x00 0x01 0x01 0x00 0x24 0x01 0x01 0x00 0x00 0x00 0x00 0x25 0x01 0x01 0x00 0x00 0x00 0x00 0x26 0x01 0x01 0x00 0x00 0x00 0x00 0x27 0x01 0x01 0x00 0x00 0x00 0x00 0x28 0x01 0x00 0x00 0x01 0x01 0x00 0x29 0x00 0x00 0x00 0x01 0x01 0x00 0x2a 0x00 0x00 0x00 0x01 0x00 0x00 0x2b 0x01 0x01 0x00 0x00 0x00 0x00 0x2c 0x01 0x00 0x00 0x01 0x00 0x00 0x2d 0x01 0x01 0x01 0x00 0x00 0x00 0x2e 0x00 0x00 0x00 0x01 0x00 0x00 0x2f 0x01 0x00 0x00 0x01 0x01 0x00 0x30 0x01 0x00 0x00 0x01 0x01 0x01 0x31 0x01 0x00 0x00 0x01 0x01 0x01 0x32 0x00 0x00 0x00 0x01 0x00 0x01 0x33 0x00 0x00 0x00 0x01 0x00 0x01 0x34 0x01 0x01 0x00 0x01 0x00 0x00 0x35 0x01 0x01 0x00 0x01 0x00 0x00 0x36 0x01 0x01 0x00 0x01 0x00 0x00 0x37 0x01 0x01 0x00 0x01 0x00 0x00 0x38 0x01 0x01 0x00 0x01 0x00 0x00 0x39 0x01 0x01 0x00 0x01 0x00 0x00 0x3a 0x00 0x00 0x00 0x01 0x00 0x00 0x3b 0x01 0x00 0x00 0x01 0x00 0x00 0x3c 0x01 0x00 0x00 0x01 0x00 0x00 0x3d 0x01 0x00 0x00 0x01 0x00 0x00 0x3e 0x01 0x00 0x00 0x01 0x00 0x00 0x3f 0x01 0x00 0x00 0x01 0x00 0x00 0x40 0x01 0x00 0x00 0x01 0x00 0x00 0x41 0x02 0x00 0x00 0x01 0x00 0x00 0x42 0x02 0x00 0x00 0x01 0x00 0x00 0x43 0x01 0x00 0x00 0x01 0x00 0x00 0x44 0x01 0x00 0x00 0x01 0x00 0x00 0x45 0x01 0x01 0x00 0x01 0x00 0x00 0x46 0x01 0x01 0x00 0x01 0x00 0x00 0x47 0x01 0x01 0x00 0x01 0x00 0x00 0x48 0x01 0x01 0x00 0x01 0x00 0x00 0x49 0x01 0x01 0x00 0x01 0x00 0x00 0x4a 0x01 0x01 0x00 0x01 0x00 0x00 0x4b 0x01 0x01 0x00 0x01 0x00 0x00 0x4c 0x01 0x01 0x00 0x01 0x00 0x00 0x4d 0x01 0x01 0x00 0x01 0x00 0x00 0x4e 0x01 0x01 0x00 0x01 0x00 0x00 0x4f 0x01 0x00 0x00 0x01 0x00 0x00 0x50 0x01 0x00 0x00 0x01 0x00 0x00 0x51 0x01 0x00 0x00 0x01 0x01 0x01 0x52 0x01 0x00 0x00 0x01 0x01 0x01 0x53 0x01 0x00 0x00 0x01 0x01 0x01 0x54 0x01 0x00 0x00 0x01 0x01 0x01 0x55 0x01 0x01 0x00 0x01 0x00 0x00 0x56 0x01 0x01 0x00 0x01 0x00 0x00 0x57 0x00 0x00 0x00 0x01 0x00 0x00 0x58 0x00 0x00 0x00 0x01 0x00 0x00 0x59 0x00 0x00 0x00 0x01 0x00 0x00 0x5a 0x00 0x00 0x00 0x01 0x00 0x00 0x5b 0x00 0x01 0x00 0x01 0x00 0x00 0x5c 0x01 0x01 0x00 0x00 0x00 0x00 0x5d 0x01 0x00 0x00 0x01 0x01 0x00 0x5e 0x01 0x00 0x00 0x01 0x01 0x00 0x5f 0x01 0x00 0x00 0x01 0x01 0x00 0x60 0x01 0x01 0x00 0x00 0x00 0x00 0x61 0x00 0x00 0x00 0x01 0x00 0x00 0x62 0x00 0x00 0x00 0x01 0x00 0x00 0x63 0x01 0x01 0x00 0x00 0x00 0x00 0x64 0x01 0x01 0x00 0x00 0x00 0x00 0x65 0x00 0x01 0x01 0x00 0x00 0x00 0x66 0x00 0x01 0x01 0x00 0x00 0x00 0x67 0x01 0x00 0x00 0x01 0x01 0x01 0x68 0x01 0x00 0x00 0x01 0x01 0x01 0x69 0x01 0x00 0x00 0x01 0x01 0x01 0x6a 0x01 0x00 0x00 0x01 0x01 0x01 0x6b 0x00 0x01 0x00 0x00 0x00 0x00 0x6c 0x01 0x01 0x00 0x00 0x00 0x00 0x6d 0x00 0x01 0x00 0x01 0x01 0x00 0x6e 0x00 0x00 0x00 0x01 0x00 0x00 0x6f 0x00 0x00 0x00 0x01 0x00 0x00 0x70 0x00 0x00 0x00 0x01 0x00 0x00 0x71 0x00 0x00 0x00 0x01 0x00 0x00 0x72 0x00 0x00 0x00 0x01 0x00 0x00 0x73 0x00 0x00 0x00 0x01 0x00 0x00 0x74 0x00 0x00 0x00 0x01 0x00 0x00 0x75 0x00 0x00 0x00 0x01 0x00 0x00 0x76 0x00 0x00 0x00 0x01 0x00 0x00 0x77 0x00 0x00 0x00 0x01 0x00 0x00 0x78 0x01 0x00 0x00 0x01 0x00 0x00 0x79 0x01 0x00 0x00 0x01 0x00 0x00 0x7a 0x01 0x00 0x00 0x01 0x01 0x01 0x7b 0x01 0x00 0x00 0x01 0x01 0x01 0x7c 0x01 0x01 0x00 0x00 0x00 0x01 0x7d 0x01 0x00 0x00 0x01 0x01 0x01 0x7e 0x01 0x00 0x00 0x01 0x01 0x01 0x7f 0x01 0x00 0x00 0x01 0x01 0x01 0x80 0x01 0x00 0x00 0x01 0x01 0x01 0x81 0x01 0x00 0x00 0x01 0x01 0x01 0x82 0x01 0x00 0x00 0x01 0x01 0x01 0x83 0x01 0x00 0x00 0x01 0x00 0x01 0x84 0x01 0x00 0x00 0x01 0x01 0x01 0x85 0x01 0x01 0x01 0x00 0x00 0x01 0x86 0x01 0x00 0x00 0x01 0x00 0x01 0x87 0x01 0x01 0x00 0x00 0x00 0x00 0x88 0x01 0x01 0x00 0x00 0x00 0x00 0x89 0x01 0x01 0x00 0x00 0x00 0x00 0x8a 0x01 0x01 0x00 0x00 0x00 0x00 0x8b 0x01 0x01 0x00 0x00 0x00 0x00 0x8c 0x01 0x00 0x00 0x01 0x00 0x00 0x8d 0x01 0x00 0x00 0x01 0x00 0x00 0x8e 0x01 0x00 0x00 0x01 0x00 0x00 0x8f 0x01 0x00 0x00 0x01 0x00 0x00 0x90 0x01 0x00 0x00 0x01 0x00 0x00 0x91 0x01 0x01 0x01 0x00 0x00 0x00 0x92 0x01 0x00 0x00 0x01 0x00 0x00 0x93 0x01 0x01 0x00 0x00 0x00 0x00 0x94 0x01 0x01 0x00 0x00 0x00 0x00 0x95 0x01 0x01 0x00 0x00 0x00 0x00 0x96 0x00 0x01 0x00 0x01 0x00 0x00 0x97 0x00 0x01 0x00 0x01 0x00 0x00 0x98 0x00 0x00 0x00 0x01 0x00 0x00 0x99 0x00 0x01 0x00 0x01 0x00 0x00 0x9a 0x00 0x01 0x00 0x01 0x00 0x00 0x9b 0x07 0x01 0x00 0x00 0x00 0x00 0x9c 0x07 0x00 0x00 0x01 0x00 0x00 0x9d 0x07 0x00 0x00 0x01 0x00 0x00 0x9e 0x07 0x00 0x00 0x01 0x00 0x00 0x9f 0x00 0x01 0x00 0x01 0x00 0x00 0xa0 0x00 0x00 0x00 0x01 0x00 0x00 0xa1 0x01 0x00 0x00 0x01 0x01 0x01 0xa2 0x01 0x00 0x00 0x01 0x01 0x01 0xa3 0x00 0x00 0x00 0x00 0x00 0x00 0xa4 0x00 0x00 0x00 0x00 0x00 0x00 0xa5 0x00 0x00 0x00 0x00 0x00 0x00 0xa6 0x00 0x00 0x00 0x00 0x00 0x00 0xa7 0x00 0x00 0x00 0x01 0x00 0x00 0xa8 0x00 0x00 0x00 0x01 0x00 0x00 0xa9 0x00 0x00 0x00 0x00 0x00 0x00 0xaa 0x00 0x00 0x00 0x01 0x00 0x00 0xab 0x00 0x00 0x00 0x01 0x00 0x00 0xac 0x00 0x01 0x00 0x00 0x00 0x00 0xad 0x00 0x01 0x00 0x00 0x00 0x00 0xae 0x00 0x01 0x01 0x00 0x00 0x00 0xaf 0x00 0x00 0x00 0x01 0x00 0x00 0xb0 0x00 0x00 0x00 0x01 0x00 0x00 0xb1 0x00 0x00 0x00 0x01 0x00 0x00 0xb2 0x00 0x00 0x00 0x00 0x00 0x00 0xb3 0x00 0x00 0x00 0x01 0x00 0x00>;
		};
	};

	fragment@50 {
		target = <0xffffffff>;

		__overlay__ {
			interrupt-parent = <0xffffffff>;
			interrupts = <0x00 0x02 0x00 0x00>;
			status = "okay";
		};
	};

	fragment@51 {
		target = <0xffffffff>;

		__overlay__ {
			interrupt-parent = <0xffffffff>;
			interrupts = <0x01 0x02 0x01 0x00>;
			status = "okay";
		};
	};

	fragment@52 {
		target = <0xffffffff>;

		__overlay__ {
			interrupt-parent = <0xffffffff>;
			interrupts = <0x02 0x08 0x02 0x00>;
			deb-gpios = <0xffffffff 0x02 0x00>;
			debounce = <0x7d000>;
			status = "okay";
		};
	};

	fragment@53 {
		target = <0xffffffff>;

		__overlay__ {
			interrupt-parent = <0xffffffff>;
			interrupts = <0x05 0x02 0x05 0x00>;
			status = "okay";
		};
	};

	fragment@54 {
		target = <0xffffffff>;

		__overlay__ {
			interrupt-parent = <0xffffffff>;
			interrupts = <0x0b 0x02 0x0b 0x00>;
			status = "okay";
		};
	};

	fragment@55 {
		target = <0xffffffff>;

		__overlay__ {
			interrupt-parent = <0xffffffff>;
			interrupts = <0x13 0x08 0x13 0x00>;
			deb-gpios = <0xffffffff 0x13 0x00>;
			debounce = <0x3e800>;
			status = "okay";
		};
	};

	fragment@56 {
		target = <0xffffffff>;

		__overlay__ {
			interrupt-parent = <0xffffffff>;
			interrupts = <0x29 0x08 0x29 0x00>;
			deb-gpios = <0xffffffff 0x29 0x00>;
			debounce = <0x7d00>;
			status = "okay";
		};
	};

	fragment@57 {
		target = <0xffffffff>;

		__overlay__ {
			interrupt-parent = <0xffffffff>;
			interrupts = <0x2c 0x01 0x2c 0x01>;
			status = "okay";
		};
	};

	fragment@58 {
		target = <0xffffffff>;

		__overlay__ {
			interrupt-parent = <0xffffffff>;
			interrupts = <0x90 0x04 0x90 0x01>;
			status = "okay";
		};
	};

	fragment@59 {
		target = <0xffffffff>;

		__overlay__ {
			compatible = "mediatek,md1_sim1_hot_plug_eint-eint";
			interrupts = <0x00 0x08>;
			debounce = <0x00 0x2710>;
			dedicated = <0x00 0x00>;
			src_pin = <0x00 0x01>;
			sockettype = <0x00 0x00>;
			status = "okay";
		};
	};

	fragment@60 {
		target = <0xffffffff>;

		__overlay__ {
			regulator-name = "vcama";
			regulator-default-on = <0x01>;
			status = "okay";
		};
	};

	fragment@61 {
		target = <0xffffffff>;

		__overlay__ {
			regulator-name = "vsim1";
			regulator-default-on = <0x01>;
			status = "okay";
		};
	};

	fragment@62 {
		target = <0xffffffff>;

		__overlay__ {
			regulator-name = "vsim2";
			regulator-default-on = <0x01>;
			status = "okay";
		};
	};

	fragment@63 {
		target = <0xffffffff>;

		__overlay__ {
			regulator-name = "vcamd";
			regulator-default-on = <0x01>;
			status = "okay";
		};
	};

	fragment@64 {
		target = <0xffffffff>;

		__overlay__ {
			regulator-name = "vcamio";
			regulator-default-on = <0x01>;
			status = "okay";
		};
	};

	fragment@65 {
		target = <0xffffffff>;

		__overlay__ {
			regulator-name = "vldo28";
			regulator-default-on = <0x01>;
			status = "okay";
		};
	};

	fragment@66 {
		target = <0xffffffff>;

		__overlay__ {
			vcama-supply = <0xffffffff>;
			vcama_sub-supply = <0xffffffff>;
			vcama_main2-supply = <0xffffffff>;
			vcamd-supply = <0xffffffff>;
			vcamd_sub-supply = <0xffffffff>;
			vcamio-supply = <0xffffffff>;
			vcamio_sub-supply = <0xffffffff>;
			vcamio_main2-supply = <0xffffffff>;
			vcamaf-supply = <0xffffffff>;
			status = "okay";
		};
	};

	fragment@67 {
		target = <0xffffffff>;

		__overlay__ {
			vtouch-supply = <0xffffffff>;
			status = "okay";
		};
	};

	fragment@68 {
		target = <0xffffffff>;

		__overlay__ {
			mediatek,kpd-key-debounce = <0x400>;
			mediatek,kpd-sw-pwrkey = <0x74>;
			mediatek,kpd-hw-pwrkey = <0x08>;
			mediatek,kpd-sw-rstkey = <0x73>;
			mediatek,kpd-hw-rstkey = <0x11>;
			mediatek,kpd-use-extend-type = <0x00>;
			mediatek,kpd-hw-map-num = <0x48>;
			mediatek,kpd-hw-init-map = <0x00 0x72 0x00 0x00 0x00 0x00 0x00 0x00 0x00 0x00 0x00 0x00 0x00 0x00 0x00 0x00 0x00 0x00 0x00 0x00 0x00 0x00 0x00 0x00 0x00 0x00 0x00 0x00 0x00 0x00 0x00 0x00 0x00 0x00 0x00 0x00 0x00 0x00 0x00 0x00 0x00 0x00 0x00 0x00 0x00 0x00 0x00 0x00 0x00 0x00 0x00 0x00 0x00 0x00 0x00 0x00 0x00 0x00 0x00 0x00 0x00 0x00 0x00 0x00 0x00 0x00 0x00 0x00 0x00 0x00 0x00 0x00>;
			mediatek,kpd-pwrkey-eint-gpio = <0x00>;
			mediatek,kpd-pwkey-gpio-din = <0x00>;
			mediatek,kpd-hw-dl-key0 = <0x11>;
			mediatek,kpd-hw-dl-key1 = <0x01>;
			mediatek,kpd-hw-dl-key2 = <0x08>;
			mediatek,kpd-hw-recovery-key = <0x11>;
			mediatek,kpd-hw-factory-key = <0x01>;
			status = "okay";
		};
	};

	__symbols__ {
		led0 = "/fragment@1/__overlay__/led@0";
		led1 = "/fragment@1/__overlay__/led@1";
		led2 = "/fragment@1/__overlay__/led@2";
		led3 = "/fragment@1/__overlay__/led@3";
		led4 = "/fragment@1/__overlay__/led@4";
		led5 = "/fragment@1/__overlay__/led@5";
		led6 = "/fragment@1/__overlay__/led@6";
		vibrator0 = "/fragment@1/__overlay__/vibrator@0";
		memory_ssmr_features = "/fragment@1/__overlay__/memory-ssmr-features";
		focaltech_touch_mtk = "/fragment@5/__overlay__/focaltech_touch@38";
		ili9881x_touch = "/fragment@5/__overlay__/ili9881x_touch@42";
		ilitek_touch_mtk = "/fragment@5/__overlay__/ilitek_touch@41";
		chipone_tddi_mtk = "/fragment@5/__overlay__/chipone_touch@48";
		ctp_pins_default = "/fragment@7/__overlay__/eint0default";
		ctp_pins_eint_as_int = "/fragment@7/__overlay__/eint@0";
		ctp_pins_eint_output0 = "/fragment@7/__overlay__/eintoutput0";
		ctp_pins_eint_output1 = "/fragment@7/__overlay__/eintoutput1";
		ctp_pins_rst_output0 = "/fragment@7/__overlay__/rstoutput0";
		ctp_pins_rst_output1 = "/fragment@7/__overlay__/rstoutput1";
		mtkfb_pins_mode_te_gpio = "/fragment@9/__overlay__/mode_te_gpio";
		mtkfb_pins_mode_te_te = "/fragment@9/__overlay__/mode_te_te";
		mtkfb_pins_lcm_reset0 = "/fragment@9/__overlay__/lcm_rst_out0_gpio";
		mtkfb_pins_lcm_reset1 = "/fragment@9/__overlay__/lcm_rst_out1_gpio";
		mtkfb_pins_lcd_bias_enp0 = "/fragment@9/__overlay__/lcd_bias_enp0_gpio";
		mtkfb_pins_lcd_bias_enp1 = "/fragment@9/__overlay__/lcd_bias_enp1_gpio";
		mtkfb_pins_lcd_bias_enn0 = "/fragment@9/__overlay__/lcd_bias_enn0_gpio";
		mtkfb_pins_lcd_bias_enn1 = "/fragment@9/__overlay__/lcd_bias_enn1_gpio";
		consys_pins_default = "/fragment@11/__overlay__/consys_default";
		gpslna_pins_init = "/fragment@11/__overlay__/gpslna@0";
		gpslna_pins_oh = "/fragment@11/__overlay__/gpslna@1";
		gpslna_pins_ol = "/fragment@11/__overlay__/gpslna@2";
		accdet_pins_default = "/fragment@14/__overlay__/accdetdefault";
		accdet_pins_eint_as_int = "/fragment@14/__overlay__/accdeteint@0";
		usbcable_pins_default = "/fragment@16/__overlay__/usbcableeint@0";
		red_led_default = "/fragment@18/__overlay__/led_default";
		red_led_pull_down = "/fragment@18/__overlay__/led_output0";
		red_led_pull_up = "/fragment@18/__overlay__/led_output1";
		irtx_gpio_led_default = "/fragment@20/__overlay__/irtx_gpio_led_def@gpio90";
		irtx_gpio_led_set = "/fragment@20/__overlay__/irtx_gpio_led_set@gpio90";
		aud_extamp_gpio_low = "/fragment@22/__overlay__/aud_extamp_gpio_low";
		aud_extamp_gpio_high = "/fragment@22/__overlay__/aud_extamp_gpio_high";
		camera_pins_cam0_mclk_on = "/fragment@26/__overlay__/camera_pins_cam0_mclk_on";
		camera_pins_cam0_mclk_off = "/fragment@26/__overlay__/camera_pins_cam0_mclk_off";
		camera_pins_cam1_mclk_on = "/fragment@26/__overlay__/camera_pins_cam1_mclk_on";
		camera_pins_cam1_mclk_off = "/fragment@26/__overlay__/camera_pins_cam1_mclk_off";
		camera_pins_cam2_mclk_on = "/fragment@26/__overlay__/camera_pins_cam2_mclk_on";
		camera_pins_cam2_mclk_off = "/fragment@26/__overlay__/camera_pins_cam2_mclk_off";
		camera_pins_cam0_rst0 = "/fragment@26/__overlay__/cam0@0";
		camera_pins_cam0_rst1 = "/fragment@26/__overlay__/cam0@1";
		camera_pins_cam0_pnd0 = "/fragment@26/__overlay__/cam0@2";
		camera_pins_cam0_pnd1 = "/fragment@26/__overlay__/cam0@3";
		camera_pins_cam1_rst0 = "/fragment@26/__overlay__/cam1@0";
		camera_pins_cam1_rst1 = "/fragment@26/__overlay__/cam1@1";
		camera_pins_cam1_pnd0 = "/fragment@26/__overlay__/cam1@2";
		camera_pins_cam1_pnd1 = "/fragment@26/__overlay__/cam1@3";
		camera_pins_cam2_rst0 = "/fragment@26/__overlay__/cam2@0";
		camera_pins_cam2_rst1 = "/fragment@26/__overlay__/cam2@1";
		camera_pins_cam2_pnd0 = "/fragment@26/__overlay__/cam2@2";
		camera_pins_cam2_pnd1 = "/fragment@26/__overlay__/cam2@3";
		camera_pins_cam_ldo_rear_vcamd_0 = "/fragment@26/__overlay__/cam0@vcamd0";
		camera_pins_cam_ldo_rear_vcamd_1 = "/fragment@26/__overlay__/cam0@vcamd1";
		camera_pins_cam_ldo_sub_vcamd_0 = "/fragment@26/__overlay__/cam1@vcamd0";
		camera_pins_cam_ldo_sub_vcamd_1 = "/fragment@26/__overlay__/cam1@vcamd1";
		camera_pins_cam_ldo_sub_vcama_0 = "/fragment@26/__overlay__/cam1@vcama0";
		camera_pins_cam_ldo_sub_vcama_1 = "/fragment@26/__overlay__/cam1@vcama1";
		camera_pins_cam_ldo_rear2_vcamd_0 = "/fragment@26/__overlay__/cam2@vcama0";
		camera_pins_cam_ldo_rear2_vcamd_1 = "/fragment@26/__overlay__/cam2@vcama1";
		camera_pins_cam_ldo_rear2_vcama_0 = "/fragment@26/__overlay__/cam2@vcamd0";
		camera_pins_cam_ldo_rear2_vcama_1 = "/fragment@26/__overlay__/cam2@vcamd1";
		camera_pins_default = "/fragment@26/__overlay__/camdefault";
		flashlight_pin_default = "/fragment@28/__overlay__/default";
		flashlight_pin_hwen_high = "/fragment@28/__overlay__/hwen_high";
		flashlight_pin_hwen_low = "/fragment@28/__overlay__/hwen_low";
		flashlight_pin_strobe_high = "/fragment@28/__overlay__/strobe_high";
		flashlight_pin_strobe_low = "/fragment@28/__overlay__/strobe_low";
		fpsensor_spi_default = "/fragment@30/__overlay__/fpsensor_spi_default";
		fpsensor_spi_cs_en0 = "/fragment@30/__overlay__/fpsensor_spi_cs_low";
		fpsensor_spi_cs_en1 = "/fragment@30/__overlay__/fpsensor_spi_cs_high";
		fpsensor_spi_mi_mode_en0 = "/fragment@30/__overlay__/fpsensor_spi_mi_low";
		fpsensor_spi_mi_mode_en1 = "/fragment@30/__overlay__/fpsensor_spi_mi_high";
		fpsensor_spi_mo_mode_en0 = "/fragment@30/__overlay__/fpsensor_spi_mo_low";
		fpsensor_spi_mo_mode_en1 = "/fragment@30/__overlay__/fpsensor_spi_mo_high";
		fpsensor_spi_mclk_mode_en0 = "/fragment@30/__overlay__/fpsensor_spi_mclk_low";
		fpsensor_spi_mclk_mode_en1 = "/fragment@30/__overlay__/fpsensor_spi_mclk_high";
		fpsensor_finger_rst_mode_en0 = "/fragment@30/__overlay__/fpsensor_finger_rst_low";
		fpsensor_finger_rst_mode_en1 = "/fragment@30/__overlay__/fpsensor_finger_rst_high";
		fpsensor_finger_power_en0 = "/fragment@30/__overlay__/fpsensor_finger_power_low";
		fpsensor_finger_power_en1 = "/fragment@30/__overlay__/fpsensor_finger_power_high";
		fpsensor_fp_eint_as_int = "/fragment@30/__overlay__/fpsensor_eint_as_int";
		fpsensor_fp_eint_in_low = "/fragment@30/__overlay__/fpsensor_eint_in_low";
		fpsensor_fp_eint_in_float = "/fragment@30/__overlay__/fpsensor_eint_in_float";
		fpsensor_finger_cs_mode_en0 = "/fragment@30/__overlay__/fpsensor_finger_cs_low";
		fpsensor_finger_cs_mode_en1 = "/fragment@30/__overlay__/fpsensor_finger_cs_high";
		sar_mtk = "/fragment@39/__overlay__/sar@28";
		alsps_mtk = "/fragment@39/__overlay__/alsps@46";
		camera_main_eeprom_mtk = "/fragment@40/__overlay__/camera_main_eeprom@50";
		camera_main_mtk = "/fragment@40/__overlay__/camera_main@1a";
		camera_main_af_mtk = "/fragment@40/__overlay__/camera_main_af@0c";
		camera_sub_mtk = "/fragment@42/__overlay__/camera_sub@2d";
		camera_main_two_mtk = "/fragment@42/__overlay__/camera_main_two@2f";
		strobe_main_mtk = "/fragment@44/__overlay__/strobe_main@63";
	};

	__fixups__ {
		chosen = "/fragment@0:target:0";
		odm = "/fragment@1:target:0";
		i2c3 = "/fragment@2:target:0\0/fragment@25:target:0\0/fragment@41:target:0";
		i2c5 = "/fragment@3:target:0\0/fragment@43:target:0";
		i2c6 = "/fragment@4:target:0\0/fragment@8:target:0\0/fragment@44:target:0";
		i2c0 = "/fragment@5:target:0\0/fragment@38:target:0";
		touch = "/fragment@6:target:0\0/fragment@50:target:0\0/fragment@67:target:0";
		pio = "/fragment@7:target:0\0/fragment@9:target:0\0/fragment@11:target:0\0/fragment@14:target:0\0/fragment@15/__overlay__:usbcable-gpio:0\0/fragment@16:target:0\0/fragment@18:target:0\0/fragment@20:target:0\0/fragment@22:target:0\0/fragment@23/__overlay__:mt6370,intr_gpio:0\0/fragment@24/__overlay__:mt6370pd,intr_gpio:0\0/fragment@25/__overlay__/rt9465@4b:rt,en_gpio:0\0/fragment@25/__overlay__/rt9465@4b:rt,intr_gpio:0\0/fragment@26:target:0\0/fragment@28:target:0\0/fragment@30:target:0\0/fragment@39/__overlay__/sar@28:interrupt-parent:0\0/fragment@39/__overlay__/alsps@46:interrupt-parent:0\0/fragment@48/__overlay__:GPIO_SIM2_SIO:0\0/fragment@48/__overlay__:GPIO_SIM2_SRST:0\0/fragment@48/__overlay__:GPIO_SIM2_SCLK:0\0/fragment@48/__overlay__:GPIO_SIM1_SCLK:0\0/fragment@48/__overlay__:GPIO_SIM1_SRST:0\0/fragment@48/__overlay__:GPIO_SIM1_SIO:0\0/fragment@48/__overlay__:GPIO_SIM1_HOT_PLUG:0\0/fragment@50/__overlay__:interrupt-parent:0\0/fragment@51/__overlay__:interrupt-parent:0\0/fragment@52/__overlay__:interrupt-parent:0\0/fragment@52/__overlay__:deb-gpios:0\0/fragment@53/__overlay__:interrupt-parent:0\0/fragment@54/__overlay__:interrupt-parent:0\0/fragment@55/__overlay__:interrupt-parent:0\0/fragment@55/__overlay__:deb-gpios:0\0/fragment@56/__overlay__:interrupt-parent:0\0/fragment@56/__overlay__:deb-gpios:0\0/fragment@57/__overlay__:interrupt-parent:0\0/fragment@58/__overlay__:interrupt-parent:0";
		mtkfb = "/fragment@10:target:0";
		consys = "/fragment@12:target:0";
		accdet = "/fragment@13:target:0";
		usb_cable = "/fragment@15:target:0\0/fragment@55:target:0";
		led_simple = "/fragment@17:target:0";
		irtx_pwm = "/fragment@19:target:0";
		audgpio = "/fragment@21:target:0";
		mt6370_pmu = "/fragment@23:target:0";
		mt6370_typec = "/fragment@24:target:0";
		kd_camera_hw1 = "/fragment@27:target:0\0/fragment@66:target:0";
		flashlights_aw3643 = "/fragment@29:target:0";
		fingerprint_fpsensor = "/fragment@31:target:0\0/fragment@53:target:0";
		usb_phy_tuning = "/fragment@32:target:0";
		charger = "/fragment@33:target:0";
		bat_gm30 = "/fragment@34:target:0\0/fragment@35:target:0";
		auxadc = "/fragment@36:target:0";
		pmic_clock_buffer_ctrl = "/fragment@37:target:0";
		i2c1 = "/fragment@39:target:0";
		i2c2 = "/fragment@40:target:0";
		i2c4 = "/fragment@42:target:0";
		i2c7 = "/fragment@45:target:0";
		i2c8 = "/fragment@46:target:0";
		i2c9 = "/fragment@47:target:0";
		gpio_usage_mapping = "/fragment@48:target:0";
		gpio = "/fragment@49:target:0";
		msdc1_ins = "/fragment@51:target:0";
		mrdump_ext_rst = "/fragment@52:target:0";
		subpmic_pmu_eint = "/fragment@54:target:0";
		otg_iddig = "/fragment@56:target:0";
		dsi_te = "/fragment@57:target:0";
		main_pmic = "/fragment@58:target:0";
		md1_sim1_hot_plug_eint = "/fragment@59:target:0";
		mt_pmic_vcama_ldo_reg = "/fragment@60:target:0\0/fragment@66/__overlay__:vcama-supply:0\0/fragment@66/__overlay__:vcama_sub-supply:0\0/fragment@66/__overlay__:vcama_main2-supply:0";
		mt_pmic_vsim1_ldo_reg = "/fragment@61:target:0";
		mt_pmic_vsim2_ldo_reg = "/fragment@62:target:0";
		mt_pmic_vcamd_ldo_reg = "/fragment@63:target:0\0/fragment@66/__overlay__:vcamd-supply:0\0/fragment@66/__overlay__:vcamd_sub-supply:0";
		mt_pmic_vcamio_ldo_reg = "/fragment@64:target:0\0/fragment@66/__overlay__:vcamio-supply:0\0/fragment@66/__overlay__:vcamio_sub-supply:0\0/fragment@66/__overlay__:vcamio_main2-supply:0";
		mt_pmic_vldo28_ldo_reg = "/fragment@65:target:0\0/fragment@66/__overlay__:vcamaf-supply:0\0/fragment@67/__overlay__:vtouch-supply:0";
		keypad = "/fragment@68:target:0";
	};

	__local_fixups__ {

		fragment@6 {

			__overlay__ {
				pinctrl-0 = <0x00>;
				pinctrl-1 = <0x00>;
				pinctrl-2 = <0x00>;
				pinctrl-3 = <0x00>;
				pinctrl-4 = <0x00>;
				pinctrl-5 = <0x00>;
			};
		};

		fragment@10 {

			__overlay__ {
				pinctrl-0 = <0x00>;
				pinctrl-1 = <0x00>;
				pinctrl-2 = <0x00>;
				pinctrl-3 = <0x00>;
				pinctrl-4 = <0x00>;
				pinctrl-5 = <0x00>;
				pinctrl-6 = <0x00>;
				pinctrl-7 = <0x00>;
			};
		};

		fragment@12 {

			__overlay__ {
				pinctrl-0 = <0x00>;
				pinctrl-1 = <0x00>;
				pinctrl-2 = <0x00>;
				pinctrl-3 = <0x00>;
			};
		};

		fragment@13 {

			__overlay__ {
				pinctrl-0 = <0x00>;
				pinctrl-1 = <0x00>;
			};
		};

		fragment@15 {

			__overlay__ {
				pinctrl-0 = <0x00>;
			};
		};

		fragment@17 {

			__overlay__ {
				pinctrl-0 = <0x00>;
				pinctrl-1 = <0x00>;
				pinctrl-2 = <0x00>;
			};
		};

		fragment@19 {

			__overlay__ {
				pinctrl-0 = <0x00>;
				pinctrl-1 = <0x00>;
			};
		};

		fragment@21 {

			__overlay__ {
				pinctrl-0 = <0x00>;
				pinctrl-1 = <0x00>;
			};
		};

		fragment@27 {

			__overlay__ {
				pinctrl-0 = <0x00>;
				pinctrl-1 = <0x00>;
				pinctrl-2 = <0x00>;
				pinctrl-3 = <0x00>;
				pinctrl-4 = <0x00>;
				pinctrl-5 = <0x00>;
				pinctrl-6 = <0x00>;
				pinctrl-7 = <0x00>;
				pinctrl-8 = <0x00>;
				pinctrl-9 = <0x00>;
				pinctrl-10 = <0x00>;
				pinctrl-11 = <0x00>;
				pinctrl-12 = <0x00>;
				pinctrl-13 = <0x00>;
				pinctrl-14 = <0x00>;
				pinctrl-15 = <0x00>;
				pinctrl-16 = <0x00>;
				pinctrl-17 = <0x00>;
				pinctrl-18 = <0x00>;
				pinctrl-19 = <0x00>;
				pinctrl-20 = <0x00>;
				pinctrl-21 = <0x00>;
				pinctrl-22 = <0x00>;
				pinctrl-23 = <0x00>;
				pinctrl-24 = <0x00>;
				pinctrl-25 = <0x00>;
				pinctrl-26 = <0x00>;
				pinctrl-27 = <0x00>;
				pinctrl-28 = <0x00>;
			};
		};

		fragment@29 {

			__overlay__ {
				pinctrl-0 = <0x00>;
				pinctrl-1 = <0x00>;
				pinctrl-2 = <0x00>;
				pinctrl-3 = <0x00>;
				pinctrl-4 = <0x00>;
			};
		};

		fragment@31 {

			__overlay__ {
				pinctrl-0 = <0x00>;
				pinctrl-1 = <0x00>;
				pinctrl-2 = <0x00>;
				pinctrl-3 = <0x00>;
				pinctrl-4 = <0x00>;
				pinctrl-5 = <0x00>;
				pinctrl-6 = <0x00>;
				pinctrl-7 = <0x00>;
				pinctrl-8 = <0x00>;
				pinctrl-9 = <0x00>;
				pinctrl-10 = <0x00>;
				pinctrl-11 = <0x00>;
				pinctrl-12 = <0x00>;
				pinctrl-13 = <0x00>;
				pinctrl-14 = <0x00>;
				pinctrl-15 = <0x00>;
				pinctrl-16 = <0x00>;
				pinctrl-17 = <0x00>;
			};
		};
	};
};
